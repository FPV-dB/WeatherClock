// SmallTV Ultra (GeekMagic, ESP8266) - alternative firmware
// Weather Clock: clock faces + weather + photo/GIF album + night brightness (base: SmallTV Pomodoro)
//
// Hardware (source: devices.esphome.io/devices/geekmagic-ultra):
//   ST7789 240x240 screen, hardware SPI CLK=GPIO14 MOSI=GPIO13, no CS (SPI mode 3)
//   DC=GPIO0  RST=GPIO2  Backlight=GPIO5 (inverted PWM)
// Flash: 4M2M layout (program up to ~1 MB; LittleFS at 0x200000-0x3FA000). Up to 1.23 the layout was 4M3M, like
// the original firmware (LittleFS at 0x100000-0x3FA000, constants from the V9.0.50 binary, offset 0x14d00), which
// left only ~1 MB for the program and the update copy. EEPROM (0x3FB000), RF cal and SDK data sit
// at the same addresses in both layouts, so the settings survive; it's the LittleFS that moves: on the
// first 4M2M boot it is formatted (see fsMount). The same source still builds as 4M3M (LAYOUT=4M3M
// in build.sh), for a transition version that only carries the new panel.

#include <Arduino.h>
#include <ESP8266WiFi.h>
#include <ESP8266WebServer.h>
#include <base64.h>
#include <DNSServer.h>
#include <EEPROM.h>
#include <LittleFS.h>
#include <SPI.h>
#include <Adafruit_GFX.h>
#include <Adafruit_ST7789.h>
#include <ArduinoJson.h>
#include <WiFiUdp.h>
#include <eboot_command.h>
#include <bearssl/bearssl_hash.h>  // SHA-256 of the received panel (/api/panel)
#include <bearssl/bearssl_rsa.h>  // update signature check (RSA-2048)
#include <StackThunk.h>
#include <libb64/cdecode.h>
#include "ota_key.h"  // PUBLIC key for updates (generated by scripts/sign.cjs)
#include "src/uzlib/uzlib.h"  // the same decompressor as the boot loader (zlib licence)
extern "C" uint32_t _FS_start;
#include "src/JPEGDEC/JPEGDEC.h"  // copy of JPEGDEC 1.8.4 with the colour tables built only during decoding
#include "src/AnimatedGIF/AnimatedGIF.h"
#include "gifcheck.h"
#include "security.h"
#include <new>
#include <vector>
#include <time.h>
#include <sys/time.h>
#include <coredecls.h>  // settimeofday_cb: tells us when SNTP changes the time
#include "ui.h"
#include "web.h"
#include "facepack.h"

void blit(int16_t x, int16_t y, uint16_t *px, int16_t w, int16_t h);  // ui.cpp: clips to the dirty area; off-screen, it lands in the strip

#define FW_VERSION "2.0.8"  // weatherbox: Weather Clock (base: smalltv-pomodoro 1.23.5)
#define HOSTNAME   "weatherclock"
#define AP_NAME    "WeatherClock-Setup"

#define PIN_DC  0
#define PIN_RST 2
#define PIN_BL  5


Adafruit_ST7789 tft(-1, PIN_DC, PIN_RST);

// Pixel rows for the screen. Adafruit GFX 1.13 sends each row through SPI.writeBytes, which reads
// memory 4 bytes at a time: with the row at an address that isn't a multiple of 4 (vector font text,
// clips, odd-width strips) the ESP8266 raises an alignment exception and restarts (issue #4).
// Every row passes through here: if misaligned, it goes through an aligned copy.
// The aligned copy uses uiRowBuf(), the same buffer as gifDraw and Flip (never in use at the same time): anything
// already aligned isn't copied. One buffer instead of three (fixed RAM).
static void tftPixels(uint16_t *px, int n) {
  if (!((uintptr_t)px & 3)) {
    tft.writePixels(px, n);
    return;
  }
  while (n > 0) {
    int k = n < 240 ? n : 240;
    memmove(uiRowBuf(), px, k * 2);  // px may be inside the buffer itself (a clipped Flip row)
    tft.writePixels(uiRowBuf(), k);
    px += k;
    n -= k;
  }
}

// drawRGBBitmap with the screen clipping done first, so each row goes through tftPixels
static void tftBitmap(int16_t x, int16_t y, uint16_t *px, int16_t w, int16_t h) {
  int x0 = max<int>(x, 0), y0 = max<int>(y, 0), x1 = min<int>(x + w, tft.width()), y1 = min<int>(y + h, tft.height());
  if (x1 <= x0 || y1 <= y0) return;
  tft.startWrite();
  tft.setAddrWindow(x0, y0, x1 - x0, y1 - y0);
  for (int r = y0; r < y1; r++) tftPixels(px + (r - y) * w + (x0 - x), x1 - x0);
  tft.endWrite();
}

ESP8266WebServer server(80);
bool panelOk();  // panel protection (further down, before setupWeb)
bool readOk();
uint16_t wifiDowngrades = 0;  // Wi-Fi downgrades blocked since power-on (see wifiGuardLoop)
bool passOk();
bool uploadAuthed();
// Plain HTML forms (setup and recovery) carry a random session code: another page
// can submit the form, but can't read the code.
String formToken;
void newFormToken() {
  char token[33];
  snprintf(token, sizeof token, "%08x%08x%08x%08x", ESP.random(), ESP.random(), ESP.random(), ESP.random());
  formToken = token;
}
String formTokenField() { return "<input type=hidden name=csrf value=\"" + formToken + "\">"; }
bool formOk() { return formToken.length() && server.arg("csrf") == formToken; }

// ---------- colours ----------
constexpr uint16_t rgb(uint8_t r, uint8_t g, uint8_t b) { return uiRgb(r, g, b); }

// ---------- settings (EEPROM) ----------
struct Settings {
  uint32_t magic;
  uint8_t work, shortBreak, longBreak, longEvery;
  uint8_t brightness;   // 5-100
  uint8_t autoStart;    // starts the next phase on its own
  uint8_t hour12;
  char tz[48];          // string POSIX TZ
  char otaPass[24];     // /update password (empty = no password)
  uint16_t todayCount;  // focus sessions today, survives restarts
  int16_t todayYday;
  uint8_t theme;        // 0 digital, 1 analog, 2 weather
  uint8_t mode;         // 0 clock only, 1 album, 2 alternate clock/album
  uint8_t albumDelay;   // seconds per item
  uint8_t nightOn, nightStart, nightEnd, nightBri;
  uint8_t weatherOn;
  uint8_t colR, colG, colB;  // clock colour
  float lat, lon;
  char city[32];
  // v4: panel tweaks (they vary from unit to unit) and the daily goal
  uint8_t bgr;          // 0 = RGB (the Ultra's default, same as smalltv-mod), 1 = BGR
  uint8_t invert;       // 1 = INVON (the IPS panel's default)
  uint8_t flip;         // 1 = rotate 180°
  uint8_t dailyGoal;    // focus goal per day
  uint8_t activity;     // focus activity (UiActivity); new field at the end: old units read garbage and fall back to the default
  char facePkg[24];     // active face pack (/faces/<id>.json) when theme == THEME_PACK; same: garbage becomes ""
  uint8_t lang;         // screen and panel language: 0 Portuguese, 1 English, 2 Spanish; same: garbage becomes 1 (English)
  uint8_t nightSun;     // night brightness from sunset to sunrise (Open-Meteo) instead of nightStart/nightEnd
  uint8_t rotMin;       // face rotation: minutes between changes (0 = off); list in /rotation.txt
  uint8_t alexa;        // 1 = shows up to Alexa as the "Pomodoro" light
  char apPass[9];       // password for the clock's own Wi-Fi networks, setup and recovery (random, shown on screen)
  uint8_t vcom, vcomChk;  // panel common voltage (VCOMS register) and calibrated mark (vcom ^ 0xDA)
  uint8_t fahr;         // 1 = temperatures in °F; garbage becomes 0
  uint8_t rainAlert;    // 1 = warns on screen when it will rain within the next hour; garbage becomes 1
  uint8_t beta;         // 1 = the panel also offers the test versions (firmware/beta.json); garbage becomes 0
  uint8_t spi80;        // reserved: was a test's 80 MHz option (the ST7789 can't keep up and the picture turns to garbage); always 0
  char devName[24];     // weatherbox: the clock's name ("Mum's clock"), shown on the start-up screen and the panel; garbage becomes ""
};
const uint32_t SETTINGS_MAGIC = 0x504F4D34;     // "POM4"
const uint32_t SETTINGS_MAGIC_V3 = 0x504F4D33;  // "POM3": same fields, without the v4 ones
Settings cfg;

void defaultSettings() {
  cfg = Settings{SETTINGS_MAGIC, 25, 5, 15, 4, 80, 0, 0, "<-03>3", "", 0, -1,
                 THEME_MATRIX, 0, 10, 0, 22, 7, 15, 1, 242, 242, 242, 0, 0, "", 0, 1, 0, 8, ACT_READ, "", 0, 0, 0, 1, "", UI_VCOM_DEFAULT, 0, 0, 1, 0, 0};
  cfg.lang = 1;   // weatherbox: English by default
  cfg.alexa = 0;  // Alexa's "Pomodoro" light belongs to the timer, which doesn't exist here
}

// ---------- recovery: 3 short boots in a row ----------
// The device has no button: powering it on and off 3 times in a row (each time for under 30 s), or a
// firmware that crashes right at start-up, opens recovery mode (its own network, update without a password,
// factory settings). The counter lives in EEPROM, after the settings: it survives unplugging,
// unlike RTC memory. 30 s powered on resets the count.
const int BOOT_OFF = 400;
static_assert(sizeof(Settings) <= BOOT_OFF, "the settings would overlap the boot counter");
struct BootCount { uint32_t magic; uint8_t n; };
const uint32_t BOOT_MAGIC = 0x424F4F54;  // "BOOT"
uint8_t bootCount = 0;
bool recoveryMode = false;

// Last crash (exception or watchdog), so the panel can say why the clock restarted. It lives in EEPROM
// after the counter and is only written when the restart was abnormal: a normal boot uses no flash.
// "up" (seconds powered on before the crash) comes from RTC memory, which the callback below fills in on a crash.
struct CrashRec { uint32_t magic; uint8_t n, reason, exc, pad; uint32_t epc, vaddr, up; char ver[8]; };
const uint32_t CRASH_MAGIC = 0x43524153;  // "CRAS"
const int CRASH_OFF = BOOT_OFF + sizeof(BootCount);
// File storage mark for the 4M2M layout: "FS2M" = the LittleFS at this address was already formatted by us.
// Without it (first boot after coming from 4M3M or the original firmware) the contents there are garbage from the old
// layout and fsMount formats it; `pend` stays 1 until the panel confirms the backup was restored.
struct FsMark { uint32_t magic; uint8_t pend; };
const uint32_t FS_MAGIC = 0x46533241;  // "FS2A"
const int FS_OFF = CRASH_OFF + sizeof(CrashRec);
FsMark fsMark;
// Last router: channel and BSSID, so the next boot connects without scanning every channel (see connectStored).
// Only written when it changes (switching networks or the router changing channel): powering on uses no flash.
struct WifiHint { uint32_t magic; uint32_t ssid; uint8_t bssid[6]; uint8_t chan, pad; };
const uint32_t WIFI_MAGIC = 0x57494648;  // "WIFH"
const int WIFIH_OFF = FS_OFF + sizeof(FsMark);
const int EE_SIZE = WIFIH_OFF + sizeof(WifiHint);
static_assert(sizeof(WifiHint) == 16, "the Wi-Fi record changed size");
static_assert(sizeof(CrashRec) == 28, "the crash record changed size");
static_assert(sizeof(FW_VERSION) <= sizeof(CrashRec::ver), "the version does not fit in the crash record");
const uint32_t CRASH_RTC_TAG = 0x55505453;  // "UPTS"
// User RTC memory: blocks 0-31 (128 bytes) belong to the command the update leaves for the eboot
// (Updater, eboot_command at 0x60001200). Writing there between the end of the update and the restart corrupts the
// command, and the eboot boots the old version (that's what 1.23.2 did when saving the time). Our data: from 32 on.
const uint32_t RTC_CRASH_BLOCK = 32;  // 2 blocks: mark and seconds powered on
CrashRec crashRec;  // magic != CRASH_MAGIC: no crash stored

// runs on a crash (the core calls it in place of the extra notice): records how long it had been on
extern "C" void custom_crash_callback(struct rst_info *, uint32_t, uint32_t) {
  uint32_t v[2] = {CRASH_RTC_TAG, millis() / 1000};
  ESP.rtcUserMemoryWrite(RTC_CRASH_BLOCK, v, sizeof v);
}

void crashLoad() {
  EEPROM.get(CRASH_OFF, crashRec);
  if (crashRec.magic != CRASH_MAGIC) crashRec.magic = 0;
  const rst_info *r = ESP.getResetInfoPtr();
  if (!r || !(r->reason == REASON_WDT_RST || r->reason == REASON_EXCEPTION_RST || r->reason == REASON_SOFT_WDT_RST)) return;
  uint32_t v[2] = {0, 0};
  ESP.rtcUserMemoryRead(RTC_CRASH_BLOCK, v, sizeof v);
  uint8_t n = crashRec.magic ? crashRec.n : 0;
  crashRec = {CRASH_MAGIC, (uint8_t)(n < 255 ? n + 1 : n), (uint8_t)r->reason, (uint8_t)r->exccause, 0,
              r->epc1, r->excvaddr, v[0] == CRASH_RTC_TAG ? v[1] : 0, {}};
  strlcpy(crashRec.ver, FW_VERSION, sizeof crashRec.ver);
  EEPROM.put(CRASH_OFF, crashRec);
  EEPROM.commit();
}

void setBootCount(uint8_t n) {
  BootCount b = {BOOT_MAGIC, n};
  EEPROM.put(BOOT_OFF, b);
  EEPROM.commit();
  bootCount = n;
}

// requested restart (Wi-Fi, update...): doesn't count as a short boot
void rtcTimeSave();
void safeRestart() {
  if (bootCount) setBootCount(0);
  rtcTimeSave();  // the time survives the restart (RTC memory): the face comes back with it
  ESP.restart();
}

void loadSettings() {
  EEPROM.begin(EE_SIZE);
  EEPROM.get(0, cfg);
  if (cfg.magic == SETTINGS_MAGIC_V3) {
    // v3 -> v4: keeps everything, fills in the new fields and remaps the themes
    // (v3: 0 digital, 1 analog, 2 weather; v4: 0 matrix, 1 scene, 2 analog, 3 weather)
    const uint8_t themeMap[3] = {THEME_MATRIX, THEME_ANALOG, THEME_WEATHER};
    cfg.theme = cfg.theme < 3 ? themeMap[cfg.theme] : THEME_MATRIX;
    cfg.bgr = 0;
    cfg.invert = 1;
    cfg.flip = 0;
    cfg.dailyGoal = 8;
    cfg.activity = ACT_READ;
    cfg.magic = SETTINGS_MAGIC;
  } else if (cfg.magic != SETTINGS_MAGIC) {
    defaultSettings();
  }
  cfg.facePkg[sizeof(cfg.facePkg) - 1] = 0;
  for (char *p = cfg.facePkg; *p; p++)  // invalid id (old memory): no pack
    if (!((*p >= 'a' && *p <= 'z') || (*p >= '0' && *p <= '9') || *p == '-' || *p == '_')) {
      cfg.facePkg[0] = 0;
      break;
    }
  if (cfg.theme >= THEME_COUNT && !(cfg.theme == THEME_PACK && cfg.facePkg[0])) cfg.theme = THEME_MATRIX;
  if (!cfg.dailyGoal) cfg.dailyGoal = 8;
  if (cfg.activity >= ACT_COUNT) cfg.activity = ACT_READ;
  if (cfg.lang > 2) cfg.lang = 1;
  if (cfg.nightSun > 1) cfg.nightSun = 0;
  if (cfg.rotMin > 240) cfg.rotMin = 0;
  if (cfg.alexa > 1) cfg.alexa = 1;  // memory of old units (0xFF): on
  if (cfg.fahr > 1) cfg.fahr = 0;
  if (cfg.rainAlert > 1) cfg.rainAlert = 1;
  if (cfg.beta > 1) cfg.beta = 0;
  cfg.spi80 = 0;  // anyone who switched it on in the test goes back to 40 MHz
  {
    bool ok = memchr(cfg.devName, 0, sizeof cfg.devName) != nullptr;
    for (const char *c = cfg.devName; ok && *c; c++) ok = *c >= 0x20 && *c < 0x7F && *c != '"' && *c != '\\';
    if (!ok) cfg.devName[0] = 0;
  }
  if (!(fabsf(cfg.lat) <= 90 && fabsf(cfg.lon) <= 180)) cfg.lat = cfg.lon = 0;  // garbage or NaN would overflow String(float)
  // password for the clock's networks: 8 letters/digits without the easily confused ones, drawn by the chip's generator
  // the first time (or if the memory holds garbage) and shown on screen while the network is up
  static const char AP_CHARS[] = "abcdefghjkmnpqrstuvwxyz23456789";
  // VCOM: only the value the user calibrated (with the mark) is kept; garbage from old memory, 1.16.0
  // (mark 0x5A) and anyone who never calibrated follow the current default
  if (cfg.vcom > 0x3F || cfg.vcomChk != (cfg.vcom ^ 0xDA)) {
    cfg.vcom = UI_VCOM_DEFAULT;
    cfg.vcomChk = 0;
  }
  bool apOk = strnlen(cfg.apPass, sizeof cfg.apPass) == 8;
  for (int i = 0; apOk && i < 8; i++) apOk = strchr(AP_CHARS, cfg.apPass[i]) != nullptr;
  if (!apOk) {
    for (int i = 0; i < 8; i++) cfg.apPass[i] = AP_CHARS[ESP.random() % (sizeof AP_CHARS - 1)];
    cfg.apPass[8] = 0;
    EEPROM.put(0, cfg);  // save right away (saveSettings comes further down)
    EEPROM.commit();
  }
  cfg.tz[sizeof(cfg.tz) - 1] = 0;
  cfg.otaPass[sizeof(cfg.otaPass) - 1] = 0;
  cfg.city[sizeof(cfg.city) - 1] = 0;
  if (cfg.albumDelay < 3) cfg.albumDelay = 3;
}

void saveSettings() {
  EEPROM.put(0, cfg);
  EEPROM.commit();
}

uint16_t clockColor() { return rgb(cfg.colR, cfg.colG, cfg.colB); }

// ---------- time ----------
bool timeValid() { return time(nullptr) > 1700000000; }
TimeGuard timeGuard;      // time confirmed by a second source (security.h); see timeGuardBegin
uint8_t statsPending = 0;  // focus sessions finished before the time was confirmed (written to the history later)
// only writes the history with a confirmed time: a forged NTP neither erases nor scrambles the days
bool timeTrusted() { return timeGuard.ok(time(nullptr), millis()); }

bool localNow(struct tm &t) {
  if (!timeValid()) return false;
  time_t now = time(nullptr);
  localtime_r(&now, &t);
  return true;
}

// Timings of the last boot, in ms since power-on (0 = hasn't happened yet); they appear in diag.boot
uint32_t bootScreenMs = 0, bootWifiMs = 0, bootTimeMs = 0, bootNtpMs = 0;
uint8_t bootTimeSrc = 0;   // where the first time came from: 1 SNTP, 2 RTC memory (software restart), 3 the weather header
uint8_t bootWifiPath = 0;  // 0 saved network (full scan), 1 stored channel and BSSID, 2 the SDK had already connected, 3 the fast path failed
uint32_t ntpAskAt = 0;  // when SNTP was (re)configured; 0 = not yet
uint8_t ntpTries = 0;
bool syncHintOn = false;  // the face has the "syncing" indicator on top (see renderClock)
bool timeSoft = false;     // fallback time (RTC or HTTP header) still without SNTP: only shown, never confirmed
void bootNote(uint8_t src) {
  if (!bootTimeMs) {
    bootTimeMs = millis() | 1;
    bootTimeSrc = src;
  }
}

void softTime(int64_t sec, uint8_t src) {
  timeval tv = {(time_t)sec, 0};
  settimeofday(&tv, nullptr);  // it isn't SNTP: the timeGuardBegin notice ignores it
  timeSoft = true;
  bootNote(src);
}

// The time passes through a software restart in RTC memory (outside the eboot's blocks 0-31 and the crash's 32-33).
// It comes back as a fallback time: shown straight away, but only SNTP together with the weather confirms it.
const uint32_t RTC_CLOCK_BLOCK = 40;
void rtcTimeSave() {
  if (!timeTrusted()) return;
  eboot_command cmd;
  if (eboot_command_read(&cmd) == 0) return;  // update waiting for the eboot: don't touch RTC memory now
  RtcClock c = rtcClockMake((uint32_t)time(nullptr), system_get_rtc_time());
  ESP.rtcUserMemoryWrite(RTC_CLOCK_BLOCK, (uint32_t *)&c, sizeof c);
}

void rtcTimeRestore() {
  RtcClock c;
  if (!ESP.rtcUserMemoryRead(RTC_CLOCK_BLOCK, (uint32_t *)&c, sizeof c)) return;
  int64_t t = rtcClockRestore(c, system_get_rtc_time(), system_rtc_clock_cali_proc());
  if (t <= 0) return;
  setenv("TZ", cfg.tz, 1);
  tzset();
  softTime(t, 2);
}

// NTP.br answers faster in Brazil; elsewhere the pool picks a nearby server. rot rotates the
// order: if the first didn't answer, lwIP only tries the next one after ~15 s (see sntpWatch).
void applyTimezone(uint8_t rot = 0) {
  const char *s[3] = {"pool.ntp.org", "time.google.com", "a.st1.ntp.br"};
  const char *z = cfg.tz;  // time zones of Brazil and neighbours: "<-03>3", "<-04>4"...
  if (z[0] == '<' && z[1] == '-' && z[2] == '0' && z[3] >= '2' && z[3] <= '5' && z[4] == '>') {
    s[0] = "a.st1.ntp.br";
    s[1] = "pool.ntp.org";
    s[2] = "time.google.com";
  }
  configTime(z, s[rot % 3], s[(rot + 1) % 3], s[(rot + 2) % 3]);
}

// ---------- brightness (with night hours) ----------
// 20 kHz PWM (outside the audible and flicker range) with 1023 steps; inverted pin (0 = fully lit).
// Gamma 2.2 curve (perceptual) over the cfg's 0-100; 1 % already gives ~1 % duty, so it doesn't go dark.
const uint16_t BL_RANGE = 1023;
const uint32_t BL_HZ = 20000;
const uint16_t BL_MIN = 10;      // minimum duty for any brightness > 0
const uint16_t BL_FADE_MS = 400;  // ramp between two levels (day/night, slider)
int curBri = -1;
uint16_t blFrom = 0, blTo = 0, blNow = 0;
uint32_t blT0 = 0;
bool blBoot = true;  // first write (boot): no ramp

uint16_t briDuty(int b) {
  if (b <= 0) return 0;
  return BL_MIN + (uint16_t)((BL_RANGE - BL_MIN) * powf(b / 100.0f, 2.2f) + 0.5f);
}

int16_t sunRise = -1, sunSet = -1;  // minutes of the day (local time), from the last weather fetch

// Called on every loop pass: moves from the current position to the target in BL_FADE_MS and only touches the PWM when it changes
bool fadeHold = false;  // weatherbox: screen dark in the middle of a change (see fadeOutNow)

void briFade() {
  if (fadeHold) return;
  uint32_t el = millis() - blT0;
  uint16_t lvl = el >= BL_FADE_MS ? blTo : blFrom + (int32_t)(blTo - blFrom) * (int32_t)el / (int32_t)BL_FADE_MS;
  if (lvl == blNow) return;
  blNow = lvl;
  analogWrite(PIN_BL, BL_RANGE - lvl);
}

void updateBrightness(bool force = false) {
  int b = cfg.brightness;
  struct tm t;
  if (cfg.nightOn && localNow(t)) {
    int h = t.tm_hour, m = h * 60 + t.tm_min, s = cfg.nightStart, e = cfg.nightEnd;
    bool night = false;
    if (cfg.nightSun && sunRise >= 0 && sunSet > sunRise) night = m < sunRise || m >= sunSet;  // from sunset to sunrise
    else if (s != e) night = s < e ? (h >= s && h < e) : (h >= s || h < e);  // fixed hours (or no sun data yet)
    if (night) b = cfg.nightBri;
  }
  if (b == curBri && !force) return;
  curBri = b;
  blFrom = blNow;
  blTo = briDuty(b);
  blT0 = millis();
  if (blBoot) {  // boot: lights straight to the requested level
    blBoot = false;
    blFrom = blTo;
    blNow = blTo;
    analogWrite(PIN_BL, BL_RANGE - blTo);
    return;
  }
  briFade();
}

// weatherbox: screen change by fading. There is no memory to blend two screens, so the brightness drops
// to zero, the new screen is drawn in the dark and the brightness comes back (briFade does the ramp up in BL_FADE_MS).
bool fadeInPending = false;
void fadeOutNow() {
  if (fadeHold) return;
  const uint16_t from = blNow;
  const uint32_t t0 = millis(), D = 220;
  for (;;) {
    const uint32_t e = millis() - t0;
    const uint16_t l = e >= D ? 0 : from - (uint32_t)from * e / D;
    analogWrite(PIN_BL, BL_RANGE - l);
    if (e >= D) break;
    delay(8);
  }
  blNow = 0;
  fadeHold = true;
  fadeInPending = true;
}
void fadeInStart() {
  if (!fadeHold) return;
  fadeHold = false;
  fadeInPending = false;
  blFrom = 0;
  blNow = 0;
  blT0 = millis();
  blTo = briDuty(curBri);
}

// ---------- Pomodoro ----------
enum Phase : uint8_t { IDLE, WORK, SHORT_BREAK, LONG_BREAK };
const char *PHASE_KEY[] = {"idle", "work", "short", "long"};
const char *PHASE_LABEL[] = {"", "FOCUS", "BREAK", "LONG BREAK"};

Phase phase = IDLE;
bool running = false;
uint32_t totalMs = 0, remainingMs = 0, lastTick = 0;
uint8_t cycleDone = 0;      // focus sessions completed in the current cycle
uint32_t alertUntil = 0;

uint8_t phaseMinutes(Phase p) {
  return p == WORK ? cfg.work : p == SHORT_BREAK ? cfg.shortBreak : cfg.longBreak;
}

// Every phase that starts gets a number (phaseSeq); when the screen finishes drawing it, with the numbers,
// shownSeq becomes that number. The panel waits for both to match before showing the countdown: it never starts
// before the clock (see "pseq"/"pshown" in /api/state).
uint16_t phaseSeq = 0, shownSeq = 0;

void startPhase(Phase p, bool run) {
  phase = p;
  totalMs = remainingMs = (uint32_t)phaseMinutes(p) * 60000UL;
  running = run;
  lastTick = millis();
  phaseSeq++;
}

void statsFocus();                      // a focus session finished (focus history, further down)
void statsRollover(const struct tm &t);  // the day changed
void statsFlush(const struct tm &t);     // writes the focus sessions that finished before the time was confirmed
extern uint16_t statsStreak, statsBest;

int8_t hookPending = -1;  // end-of-phase notice to send in the loop: 0 focus, 1 break (Alexa notices)
String hookWork, hookBreak;  // notice addresses (further down, in "end-of-phase notices")
int hookFire(const String &url);
String hookClean(String u);

void advance(bool completed) {
  if (completed) hookPending = phase == WORK ? 0 : 1;
  if (phase == WORK) {
    if (completed) {
      cycleDone++;
      cfg.todayCount++;
      saveSettings();
      statsFocus();
    }
    bool longNext = completed && cfg.longEvery && cycleDone % cfg.longEvery == 0;
    startPhase(longNext ? LONG_BREAK : SHORT_BREAK, cfg.autoStart);
  } else {
    if (phase == LONG_BREAK) cycleDone = 0;
    startPhase(WORK, cfg.autoStart);
  }
}

void tickPomodoro() {
  if (!running) return;
  uint32_t now = millis();
  uint32_t dt = now - lastTick;
  lastTick = now;
  if (dt >= remainingMs) {
    remainingMs = 0;
    alertUntil = now + 4000;
    advance(true);
  } else {
    remainingMs -= dt;
  }
}

bool colorTestRequested = false;  // handled in the loop (needs the screen)

// Face preview requested by the panel: shows another theme for a few seconds without saving.
uint8_t previewTheme = 0;
uint32_t previewUntil = 0;
bool previewActive() { return previewUntil && (int32_t)(millis() - previewUntil) < 0; }

void command(const String &c) {
  if (c == "start") {
    if (phase == IDLE) startPhase(WORK, true);
    else { running = true; lastTick = millis(); }
  } else if (c == "pause") {
    running = false;
  } else if (c == "toggle") {
    command(running ? "pause" : "start");
  } else if (c == "skip") {
    if (phase != IDLE) advance(false);
  } else if (c == "reset") {
    phase = IDLE;
    running = false;
    cycleDone = 0;
  } else if (c == "focus") {
    startPhase(WORK, true);
  } else if (c == "short") {
    startPhase(SHORT_BREAK, true);
  } else if (c == "long") {
    startPhase(LONG_BREAK, true);
  } else if (c == "colortest") {
    colorTestRequested = true;
  }
}

// ---------- Alexa ----------
// The clock shows up to Alexa as dimmable lights on a Philips Hue bridge, on the local network: no
// account, skill or cloud. It's the same protocol as Espalexa (the same replies, which Echo devices accept),
// cut down to what the Pomodoro uses and without colour: the whole library would cost ~26 KB of flash.
//   discovery: the Echo sends an M-SEARCH over SSDP (UDP 239.255.255.250:1900) and reads /description.xml;
//   control:   GET /api/<user>/lights and PUT /api/<user>/lights/<id>/state {"on":..,"bri":..}.
// Lights (the name comes out in the clock's language at discovery time):
//   Pomodoro    on: starts focus (or resumes a paused one); off: pauses, and again ends it;
//               "to 50%": a 50-minute focus
//   Break       on: short break ("to 10%": 10 minutes); off: back to focus
//   Long break  on: long break ("to 30%": 30 minutes); off: back to focus
// The lit light shows the current phase in the Alexa app.
// Network name, so nobody has to remember the IP:
//  - lanName: http://weatherclock.local; with another clock already using it, weatherclock-2.local, -3... (checked on connect)
//  - netName: "weatherclock-" + 4 hex digits of the chip, always valid as a fallback and used for DHCP.
// Only the A record, with the packet reader in security.h (tested): ESP8266mDNS would cost ~21 KB.
char netName[24], lanName[20];  // weatherbox: "weatherclock-xxxx" is longer than "smalltv-xxxx"
WiFiUDP hueUdp;
WiFiUDP mdnsUdp;
IPAddress mdnsIp;

void mdnsSend(const char *name, uint16_t id, bool legacy, bool direct) {
  uint8_t out[80], ip[4] = {mdnsIp[0], mdnsIp[1], mdnsIp[2], mdnsIp[3]};
  size_t m = mdnsAnswer(out, sizeof out, name, ip, id, legacy);
  if (!m) return;
  if (direct) mdnsUdp.beginPacket(mdnsUdp.remoteIP(), mdnsUdp.remotePort());
  else mdnsUdp.beginPacketMulticast(IPAddress(224, 0, 0, 251), 5353, mdnsIp);
  mdnsUdp.write(out, m);
  mdnsUdp.endPacket();
}

void mdnsAnnounce() {
  if (lanName[0]) mdnsSend(lanName, 0, false, false);
  mdnsSend(netName, 0, false, false);
}

bool mdnsJoin() {
  mdnsIp = WiFi.localIP();
  mdnsUdp.stop();
  return mdnsUdp.beginMulticast(mdnsIp, IPAddress(224, 0, 0, 251), 5353);
}

// Is someone already answering for this name? Asks 3 times, 250 ms each (RFC 6762, 8.1).
bool mdnsTaken(const char *name) {
  uint8_t q[48], b[256];
  size_t m = mdnsProbeQuery(q, sizeof q, name);
  for (int t = 0; t < 3 && m; t++) {
    mdnsUdp.beginPacketMulticast(IPAddress(224, 0, 0, 251), 5353, mdnsIp);
    mdnsUdp.write(q, m);
    mdnsUdp.endPacket();
    for (uint32_t t0 = millis(); millis() - t0 < 250; delay(10)) {
      if (mdnsUdp.parsePacket() <= 0) continue;
      int n = mdnsUdp.read(b, sizeof b);
      if (n > 0 && mdnsHasAnswer(b, n, name)) return true;
    }
  }
  return false;
}

// On connect: picks the free short name and announces itself.
bool mdnsUp = false;  // Wi-Fi connected on the last mdnsLoop pass (reconnected: join the group again)

void mdnsStart() {
  // No Wi-Fi power saving: dozing between beacons, the ESP8266 loses multicast packets and
  // .local disappears "sometimes". The clock lives on mains power; the cost is ~15 mA.
  WiFi.setSleepMode(WIFI_NONE_SLEEP);
  lanName[0] = 0;
  mdnsUp = true;
  if (!mdnsJoin()) return;
  for (int i = 1; i <= 9; i++) {
    char name[sizeof lanName];
    if (i == 1) strlcpy(name, HOSTNAME, sizeof name);
    else snprintf(name, sizeof name, HOSTNAME "-%d", i);
    if (!mdnsTaken(name)) {
      strlcpy(lanName, name, sizeof lanName);
      break;
    }
  }
  mdnsAnnounce();
}

void mdnsLoop() {
  if (WiFi.status() != WL_CONNECTED) {
    mdnsUp = false;
    return;
  }
  if (!mdnsUp || WiFi.localIP() != mdnsIp) {  // reconnected or the IP changed: join the group again and announce
    mdnsUp = true;
    if (mdnsJoin()) mdnsAnnounce();
  }
  int len = mdnsUdp.parsePacket();
  if (len <= 0) return;
  uint8_t b[256];  // the question comes first; the rest (known answers) can be left out
  int n = mdnsUdp.read(b, sizeof b);
  if (n <= 0) return;
  bool legacy = mdnsUdp.remotePort() != 5353, qu = false;
  uint16_t id = (uint16_t)(b[0] << 8 | b[1]);
  const char *name = lanName[0] && mdnsAsksFor(b, n, lanName, &qu) ? lanName : mdnsAsksFor(b, n, netName, &qu) ? netName : nullptr;
  if (!name) return;
  mdnsSend(name, id, legacy, legacy || qu);
  // Ordinary question (multicast answer): also send a direct copy to whoever asked. Some routers
  // don't pass multicast between Wi-Fi devices; Windows, macOS and Android accept the direct answer.
  if (!legacy && !qu) mdnsSend(name, id, false, true);
}
bool alexaUp = false;     // ouvindo a descoberta
uint8_t alexaBri = 255;   // last requested brightness (1-255)
uint32_t alexaSeen = 0;   // millis() of an Echo's last request (0 = none since power-on)
IPAddress alexaIp;        // where it came from
// last command for the panel: 0 none, 1 started/resumed focus, 2 paused, 3 focus of N min,
// 4 ended, 5 short break, 6 long break, 7 back to focus, 8 break of N min
uint8_t alexaLast = 0;
uint8_t alexaMin = 0;     // N for commands 3 and 8
char hueMac[13];          // MAC in lowercase, without ":" (the "bridge" identifier)
const int HUE_LIGHTS = 3;

// light key like Espalexa's: low 24 bits of the MAC << 7 | index (int, may be negative)
long hueKey(int i) { return (long)(int)((strtoul(hueMac + 6, nullptr, 16) << 7) | i); }

bool hueOn(int i) {
  return i == 0 ? phase == WORK && running : i == 1 ? phase == SHORT_BREAK : phase == LONG_BREAK;
}

void hueLight(String &j, int i) {
  uint8_t m[6];
  WiFi.macAddress(m);
  char id[27];
  snprintf(id, sizeof id, "%02X:%02X:%02X:%02X:%02X:%02X:00:11-%02X", m[0], m[1], m[2], m[3], m[4], m[5], i + 1);
  j += F("{\"state\":{\"on\":");
  j += hueOn(i) ? F("true") : F("false");
  j += F(",\"bri\":");
  j += i ? 254 : alexaBri - 1;
  j += F(",\"alert\":\"none\",\"mode\":\"homeautomation\",\"reachable\":true},\"type\":\"Dimmable light\",\"name\":\"");
  j += i == 0 ? tr("Pomodoro", "Pomodoro", "Pomodoro") : i == 1 ? tr("Pausa", "Break", "Pausa") : tr("Pausa longa", "Long break", "Pausa larga");
  j += F("\",\"modelid\":\"LWB010\",\"manufacturername\":\"Philips\",\"productname\":\"E1\",\"uniqueid\":\"");
  j += id;
  j += F("\",\"swversion\":\"espalexa-2.7.0\"}");
}

// a light's command: on, off or brightness (minutes)
void hueCommand(int i, const String &body) {
  bool off = body.indexOf("false") > 0, bri = body.indexOf("bri") > 0;
  int min = 0;
  if (bri) {
    int b = body.substring(body.indexOf("bri") + 5).toInt();
    b = b >= 255 ? 255 : b + 1;
    if (i == 0) alexaBri = b;
    min = b * 100 / 255;
    min = min < 1 ? 1 : min > 99 ? 99 : min;
  }
  if (i == 0) {
    if (off) {
      alexaLast = phase != IDLE && running ? 2 : 4;  // running: pause; already paused (or on a break): end it
      command(alexaLast == 2 ? "pause" : "reset");
    } else if (bri) {
      startPhase(WORK, true);
      totalMs = remainingMs = min * 60000UL;
      alexaLast = 3;
    } else {
      alexaLast = 1;
      command(phase == WORK ? "start" : "focus");
    }
  } else if (off) {  // switching off a break: back to focus
    if (phase == (i == 1 ? SHORT_BREAK : LONG_BREAK)) {
      command("focus");
      alexaLast = 7;
    }
  } else {
    startPhase(i == 1 ? SHORT_BREAK : LONG_BREAK, true);
    if (bri) totalMs = remainingMs = min * 60000UL;
    alexaLast = bri ? 8 : i == 1 ? 5 : 6;
  }
  alexaMin = min;
  previewUntil = 0;  // the screen goes straight to the timer
}

void alexaApi() {
  const String &req = server.uri(), &body = server.arg("plain");
  if (!cfg.alexa || req.indexOf("api") < 0) {
    server.send(404, "text/plain", "");
    return;
  }
  if (server.hasHeader("Origin")) {  // an Echo sends no Origin; a browser does: that's another site trying to touch the timer
    server.send(403, "text/plain", "");
    return;
  }
  alexaSeen = millis() | 1;  // an Echo talked to the clock (the panel shows it)
  alexaIp = server.client().remoteIP();
  if (body.indexOf("devicetype") > 0) {  // asks for a Hue API user: anything will do
    server.send(200, "application/json", F("[{\"success\":{\"username\":\"2WLEDHardQrI3WHYTHoMcXHgEspsM8ZZRpSKtBQr\"}}]"));
    return;
  }
  int pos = req.indexOf("lights");
  long key = pos > 0 ? req.substring(pos + 7).toInt() : 0;
  int i = key & 127;  // light index in the key
  if (req.indexOf("state") > 0 && body.length()) {
    server.send(200, "application/json", F("[{\"success\":{\"/lights/1/state/\": true}}]"));
    if (i < HUE_LIGHTS) hueCommand(i, body);
    return;
  }
  String j;
  j.reserve(512);
  if (pos > 0 && key == 0) {  // all the lights
    j = '{';
    for (int k = 0; k < HUE_LIGHTS; k++) {
      j += k ? ",\"" : "\"";
      j += hueKey(k);
      j += "\":";
      hueLight(j, k);
    }
    j += '}';
  } else if (pos > 0 && i < HUE_LIGHTS) hueLight(j, i);
  else j = "{}";
  server.send(200, "application/json", j);
}

void alexaBegin() {
  if (alexaUp || !cfg.alexa) return;
  String mac = WiFi.macAddress();
  mac.replace(":", "");
  mac.toLowerCase();
  strlcpy(hueMac, mac.c_str(), sizeof hueMac);
  alexaUp = hueUdp.beginMulticast(WiFi.localIP(), IPAddress(239, 255, 255, 250), 1900);
}

// answers the Echo's SSDP searches, pointing to /description.xml
void alexaLoop() {
  if (!alexaUp) return;
  int n = hueUdp.parsePacket();
  if (n < 1) return;
  char p[256];
  int len = hueUdp.read(p, sizeof p - 1);
  p[len < 0 ? 0 : len] = 0;
  hueUdp.flush();
  if (!cfg.alexa || !strstr(p, "M-SEARCH") || !strstr(p, "ssdp:disc") ||
      !(strstr(p, "upnp:rootd") || strstr(p, "ssdp:all") || strstr(p, "asic:1")))
    return;
  // at most 4 answers per second: the Echo asks only a few times, and a small request becomes an answer
  // ~3x bigger (the clock could be used to multiply traffic on the network)
  static RateLimit ssdpLimit;
  if (!ssdpLimit.take(millis(), 4)) return;
  String ip = WiFi.localIP().toString(), r;
  r.reserve(400);
  r = F("HTTP/1.1 200 OK\r\nEXT:\r\nCACHE-CONTROL: max-age=100\r\nLOCATION: http://");
  r += ip;
  r += F(":80/description.xml\r\nSERVER: FreeRTOS/6.0.5, UPnP/1.0, IpBridge/1.17.0\r\nhue-bridgeid: ");
  r += hueMac;
  r += F("\r\nST: urn:schemas-upnp-org:device:basic:1\r\nUSN: uuid:2f402f80-da50-11e1-9b23-");
  r += hueMac;
  r += F("::upnp:rootdevice\r\n\r\n");
  hueUdp.beginPacket(hueUdp.remoteIP(), hueUdp.remotePort());
  hueUdp.write(r.c_str(), r.length());
  hueUdp.endPacket();
}

void sendHueDescription() {
  if (!cfg.alexa) {  // with Alexa switched off it doesn't announce itself (nor expose the MAC)
    server.send(404, "text/plain", "");
    return;
  }
  String ip = WiFi.localIP().toString(), x;
  x.reserve(900);
  x = F("<?xml version=\"1.0\" ?><root xmlns=\"urn:schemas-upnp-org:device-1-0\"><specVersion><major>1</major><minor>0</minor></specVersion><URLBase>http://");
  x += ip;
  x += F(":80/</URLBase><device><deviceType>urn:schemas-upnp-org:device:Basic:1</deviceType><friendlyName>Espalexa (");
  x += ip;
  x += F(":80)</friendlyName><manufacturer>Royal Philips Electronics</manufacturer><manufacturerURL>http://www.philips.com</manufacturerURL>"
         "<modelDescription>Philips hue Personal Wireless Lighting</modelDescription><modelName>Philips hue bridge 2012</modelName>"
         "<modelNumber>929000226503</modelNumber><modelURL>http://www.meethue.com</modelURL><serialNumber>");
  x += hueMac;
  x += F("</serialNumber><UDN>uuid:2f402f80-da50-11e1-9b23-");
  x += hueMac;
  x += F("</UDN><presentationURL>index.html</presentationURL></device></root>");
  server.send(200, "text/xml", x);
}

// ---------- weather (Open-Meteo, no API key) ----------
struct Weather {
  bool ok = false;
  float t = 0, tmin = 0, tmax = 0;
  int hum = 0, code = 0;
  bool day = true;
  uint16_t version = 0;
  uint8_t nd = 0;  // forecast: today and the next days
  UiDay d[UI_DAYS];
  uint8_t rainIn = 0;  // see UiWeather::rainIn
  uint8_t wind = 0, gust = 0;  // km/h (weatherbox)
  uint16_t wdir = 0;
  float feels = 0;
  uint8_t uv10 = 255;
  uint16_t aqi = 0xFFFF;
  uint8_t uvMax10 = 255;
  uint16_t pm25 = 0xFFFF, pm10 = 0xFFFF;
  uint8_t nh = 0, h0 = 0;
  int8_t ht[UI_HOURS];
  uint8_t hp[UI_HOURS];
  char tzName[40] = "";  // the city's time zone according to Open-Meteo (IANA, e.g. America/Sao_Paulo)
  int32_t utcOff = 0;     // this time zone's offset right now, in seconds (the panel compares it with the clock's)
} wx;
uint32_t wxNext = 0;
uint8_t wxFails = 0;  // consecutive weather fetches that failed

// HTTP/1.0 GET (reply without "chunked", closes at the end) instead of HTTPClient (~4 KB).
// Returns the HTTP code (negative if it can't connect) and leaves the client at the start of the body.
static bool httpLine(WiFiClient &c, String &line, uint32_t start, uint16_t timeoutMs) {
  line = "";
  while (millis() - start < timeoutMs) {
    if (c.available()) {
      int ch = c.read();
      if (ch == '\n') return true;
      if (ch < 0) continue;
      if (line.length() >= 512) return false;
      line += (char)ch;
    } else if (!c.connected()) return false;
    else delay(1);
  }
  return false;
}

// Appends a decimal already bounded by the firmware without creating another String on the heap.
static void appendFixed(String &out, float value, uint8_t digits) {
  bool neg = value < 0;
  if (neg) value = -value;
  uint32_t scale = 1;
  for (uint8_t i = 0; i < digits; i++) scale *= 10;
  uint32_t scaled = lroundf(value * scale);
  if (neg && scaled) out += '-';
  out += scaled / scale;
  if (!digits) return;
  out += '.';
  uint32_t frac = scaled % scale;
  for (uint32_t div = scale / 10; div; div /= 10) out += (char)('0' + frac / div % 10);
}

uint32_t httpDateEpoch = 0;  // Date header of the last reply (0 = there wasn't one)

int httpGet(WiFiClient &c, const String &url, uint16_t timeoutMs) {
  httpDateEpoch = 0;
  if (!safeHttpUrl(url.c_str(), url.length())) return -1;
  int end = 7;
  while (end < (int)url.length() && url[end] != '/' && url[end] != '?') end++;
  String host = url.substring(7, end), path = url.substring(end);
  if (!path.length() || path[0] == '?') path = "/" + path;
  uint16_t port = 80;
  int colon = host.indexOf(':');
  if (colon >= 0) {
    port = host.substring(colon + 1).toInt();
    host.remove(colon);
  }
  c.setTimeout(timeoutMs);
  if (!host.length() || !port || !c.connect(host.c_str(), port)) return -1;
  // Sends in parts: concatenating everything created a big temporary String on every request.
  c.print(F("GET "));
  c.print(path);
  c.print(F(" HTTP/1.0\r\nHost: "));
  c.print(host);
  c.print(F("\r\nUser-Agent: WeatherClock\r\nConnection: close\r\n\r\n"));
  uint32_t start = millis();
  String line;
  line.reserve(128);  // httpLine reuses the same capacity for the status and headers
  if (!httpLine(c, line, start, timeoutMs)) return -2;
  int sp = line.indexOf(' ');
  int code = sp > 0 ? line.substring(sp + 1).toInt() : 0;
  if (code <= 0) return -2;
  size_t total = line.length();
  for (int headers = 0; headers < 48; headers++) {
    if (!httpLine(c, line, start, timeoutMs)) return -2;
    total += line.length();
    if (total > 8192) return -2;
    if (line.length() <= 1) return code;
    if (!strncasecmp_P(line.c_str(), PSTR("date:"), 5)) {
      int64_t d = httpDateToEpoch(line.c_str() + 5);
      if (d > 0) httpDateEpoch = (uint32_t)d;
    }
  }
  return -2;
}

bool fetchWeather() {
  WiFiClient client;
  String url;
  url.reserve(384);
  url = F("http://api.open-meteo.com/v1/forecast?latitude=");
  appendFixed(url, cfg.lat, 4);
  url += F("&longitude=");
  appendFixed(url, cfg.lon, 4);
  url += F("&current=temperature_2m,relative_humidity_2m,weather_code,is_day,wind_speed_10m,wind_direction_10m,wind_gusts_10m,apparent_temperature,uv_index"
           "&hourly=temperature_2m,precipitation_probability&forecast_hours=12"
           "&daily=weather_code,temperature_2m_max,temperature_2m_min,precipitation_probability_max,sunrise,sunset,uv_index_max"
           "&minutely_15=precipitation,precipitation_probability&forecast_minutely_15=4"
           "&timezone=auto&forecast_days=");
  url += UI_DAYS;
  if (httpGet(client, url, 5000) != 200) return false;
  if (!timeValid() && httpDateEpoch) softTime(httpDateEpoch, 3);  // fallback only for display until SNTP arrives
  JsonDocument filter;
  filter["minutely_15"]["precipitation"] = true;  // 4 quarter-hours from the current one: the next hour
  filter["minutely_15"]["precipitation_probability"] = true;
  filter["current"]["temperature_2m"] = true;
  filter["current"]["relative_humidity_2m"] = true;
  filter["current"]["weather_code"] = true;
  filter["current"]["is_day"] = true;
  filter["current"]["wind_speed_10m"] = true;
  filter["current"]["wind_direction_10m"] = true;
  filter["current"]["wind_gusts_10m"] = true;
  filter["current"]["apparent_temperature"] = true;
  filter["current"]["uv_index"] = true;
  filter["hourly"]["time"][0] = true;  // only the first hour's time: gives the starting hour
  filter["hourly"]["temperature_2m"] = true;
  filter["hourly"]["precipitation_probability"] = true;
  filter["current"]["time"] = true;  // the service's local time: the second source that confirms SNTP's
  filter["utc_offset_seconds"] = true;
  filter["timezone"] = true;  // the city's time zone: the panel checks whether it matches the clock's
  filter["daily"]["weather_code"] = true;
  filter["daily"]["precipitation_probability_max"] = true;
  filter["daily"]["temperature_2m_max"] = true;
  filter["daily"]["temperature_2m_min"] = true;
  filter["daily"]["sunrise"] = true;
  filter["daily"]["sunset"] = true;
  filter["daily"]["uv_index_max"] = true;
  JsonDocument doc;
  DeserializationError err = deserializeJson(doc, client, DeserializationOption::Filter(filter));
  client.stop();
  if (err || doc["current"]["temperature_2m"].isNull()) return false;
  wx.t = doc["current"]["temperature_2m"];
  wx.hum = doc["current"]["relative_humidity_2m"];
  wx.code = doc["current"]["weather_code"];
  wx.day = doc["current"]["is_day"] | 1;
  wx.wind = (uint8_t)constrain(lroundf(doc["current"]["wind_speed_10m"] | 0.0f), 0, 255);
  wx.gust = (uint8_t)constrain(lroundf(doc["current"]["wind_gusts_10m"] | 0.0f), 0, 255);
  wx.wdir = (uint16_t)constrain(doc["current"]["wind_direction_10m"] | 0, 0, 360) % 360;
  wx.tmax = doc["daily"]["temperature_2m_max"][0];
  wx.tmin = doc["daily"]["temperature_2m_min"][0];
  wx.feels = doc["current"]["apparent_temperature"] | wx.t;
  {
    JsonVariantConst uv = doc["current"]["uv_index"];
    wx.uv10 = uv.isNull() ? 255 : (uint8_t)constrain(lroundf(uv.as<float>() * 10), 0, 254);
    JsonVariantConst um = doc["daily"]["uv_index_max"][0];
    wx.uvMax10 = um.isNull() ? 255 : (uint8_t)constrain(lroundf(um.as<float>() * 10), 0, 254);
    JsonArrayConst ht = doc["hourly"]["temperature_2m"], hp = doc["hourly"]["precipitation_probability"];
    const char *h0 = doc["hourly"]["time"][0] | (const char *)nullptr;
    const char *tp = h0 ? strchr(h0, 'T') : nullptr;
    wx.h0 = tp && strlen(tp) >= 3 ? (uint8_t)(((tp[1] - '0') * 10 + (tp[2] - '0')) % 24) : 0;
    wx.nh = 0;
    for (int i = 0; i < UI_HOURS && i < (int)ht.size(); i++) {
      float v = ht[i].as<float>();
      wx.ht[i] = (int8_t)constrain(lroundf(isfinite(v) ? v : 0), -99, 99);
      wx.hp[i] = hp[i].isNull() ? 255 : (uint8_t)constrain(hp[i].as<int>(), 0, 100);
      wx.nh = i + 1;
    }
  }
  // the reply comes over plain HTTP: bound it before converting the decimals for /api/state
  for (float *v : {&wx.t, &wx.tmax, &wx.tmin, &wx.feels}) *v = isfinite(*v) ? constrain(*v, -99.0f, 99.0f) : 0;
  // rain on the way: the first quarter-hour with real rain (≥ 0.1 mm and chance ≥ 40%), if it
  // isn't raining yet. The current one becomes "any minute" (5); the following ones, 15/30/45 min.
  bool rainingNow = (wx.code >= 51 && wx.code <= 67) || (wx.code >= 80 && wx.code <= 82) || wx.code >= 95;
  JsonArrayConst qp = doc["minutely_15"]["precipitation"], qc = doc["minutely_15"]["precipitation_probability"];
  wx.rainIn = 0;
  for (int i = 0; !rainingNow && i < 4 && i < (int)qp.size(); i++)
    if (qp[i].as<float>() >= 0.1f && (qc[i].isNull() || qc[i].as<int>() >= 40)) {
      wx.rainIn = i ? i * 15 : 5;
      break;
    }
  JsonArrayConst dc = doc["daily"]["weather_code"], dmax = doc["daily"]["temperature_2m_max"],
                 dmin = doc["daily"]["temperature_2m_min"], drain = doc["daily"]["precipitation_probability_max"];
  wx.nd = 0;
  for (int i = 0; i < UI_DAYS && i < (int)dc.size() && i < (int)dmax.size() && i < (int)dmin.size(); i++) {
    auto deg = [](float v) { return (int8_t)constrain(lroundf(v), -99, 99); };
    wx.d[i] = {dc[i].as<uint8_t>(), deg(dmin[i].as<float>()), deg(dmax[i].as<float>()),
               drain[i].isNull() ? (uint8_t)255 : (uint8_t)constrain(drain[i].as<int>(), 0, 100)};
    wx.nd = i + 1;
  }
  // "2026-10-21T05:31" (local time, timezone=auto) -> minutes of the day
  auto minutes = [](const char *iso) {
    const char *p = iso ? strchr(iso, 'T') : nullptr;
    return p && strlen(p) >= 6 ? (p[1] - '0') * 600 + (p[2] - '0') * 60 + (p[4] - '0') * 10 + (p[5] - '0') : -1;
  };
  sunRise = minutes(doc["daily"]["sunrise"][0] | (const char *)nullptr);
  sunSet = minutes(doc["daily"]["sunset"][0] | (const char *)nullptr);
  int64_t local = isoToEpoch(doc["current"]["time"] | (const char *)nullptr);
  // With a fallback time (RTC or HTTP header) the weather would only confirm against the same source: wait for SNTP.
  if (local > 0 && !timeSoft) {  // checks the time (it came over TCP): confirms the current one, or the one SNTP brought that was undone
    timeval tv;
    gettimeofday(&tv, nullptr);
    int64_t want = timeGuard.onWeather(local - doc["utc_offset_seconds"].as<int32_t>(), tv.tv_sec, millis());
    if (want != tv.tv_sec) {
      timeval w = {(time_t)want, 0};
      settimeofday(&w, nullptr);
    }
  }
  strlcpy(wx.tzName, doc["timezone"] | "", sizeof wx.tzName);
  for (char *c = wx.tzName; *c; c++)  // IANA name ("America/Sao_Paulo"): only this goes into the state JSON
    if (!isalnum((unsigned char)*c) && !strchr("/_+-", *c)) *c = 0;
  wx.utcOff = doc["utc_offset_seconds"] | 0;
  wx.ok = true;
  wx.version++;
  return true;
}

// weatherbox: US air quality index from Open-Meteo's air quality service (plain HTTP, no key), once an hour
uint32_t aqiNext = 0;
static void fetchAqi() {
  WiFiClient client;
  String url;
  url.reserve(160);
  url = F("http://air-quality-api.open-meteo.com/v1/air-quality?latitude=");
  appendFixed(url, cfg.lat, 4);
  url += F("&longitude=");
  appendFixed(url, cfg.lon, 4);
  url += F("&current=us_aqi,pm2_5,pm10");
  if (httpGet(client, url, 5000) != 200) return;
  JsonDocument filter;
  filter["current"]["us_aqi"] = true;
  filter["current"]["pm2_5"] = true;
  filter["current"]["pm10"] = true;
  JsonDocument doc;
  if (deserializeJson(doc, client, DeserializationOption::Filter(filter))) return;
  client.stop();
  JsonVariantConst a = doc["current"]["us_aqi"];
  wx.aqi = a.isNull() ? 0xFFFF : (uint16_t)constrain(a.as<int>(), 0, 999);
  auto pm = [](JsonVariantConst v) { return v.isNull() ? (uint16_t)0xFFFF : (uint16_t)constrain(lroundf(v.as<float>() * 10), 0, 9999); };
  wx.pm25 = pm(doc["current"]["pm2_5"]);
  wx.pm10 = pm(doc["current"]["pm10"]);
  wx.version++;
}

void weatherLoop() {
  if (!cfg.weatherOn || !cfg.city[0] || WiFi.status() != WL_CONNECTED) return;
  if ((int32_t)(millis() - wxNext) < 0) return;
  // every 15 min; if it fails, tries again in 2 min
  bool ok = fetchWeather();
  wxFails = ok ? 0 : wxFails < 255 ? wxFails + 1 : 255;
  wxNext = millis() + (ok ? 15UL : 2UL) * 60000UL;
  if (ok && (int32_t)(millis() - aqiNext) >= 0) {
    aqiNext = millis() + 60UL * 60000UL;
    fetchAqi();
  }
}

// The weather confirms the time while it's set up and answering; without it, two syncs are needed.
bool weatherConfirms() { return cfg.weatherOn && cfg.city[0] && wxFails < 3; }

void timeGuardBegin() {
  settimeofday_cb([](bool fromSntp) {
    if (!fromSntp) return;  // the correction below (and the weather's) also calls this notice
    timeSoft = false;
    bootNote(1);
    if (!bootNtpMs) bootNtpMs = millis() | 1;
    timeval tv;
    gettimeofday(&tv, nullptr);
    int64_t want = timeGuard.onSntp(tv.tv_sec, millis(), !weatherConfirms());
    if (want != tv.tv_sec) {  // unconfirmed jump: go back to the time that was running
      timeval w = {(time_t)want, 0};
      settimeofday(&w, nullptr);
    }
    if (!timeGuard.confirmed && weatherConfirms()) wxNext = millis();  // confirm right away via the weather
  });
}

// while the time isn't confirmed, SNTP asks every minute (the default is every hour)
extern "C" uint32_t sntp_update_delay_MS_rfc_not_less_than_15000() { return timeGuard.confirmed ? 3600000 : 60000; }

const char *weatherText(int code);  // from ui.cpp (the same text that appears on screen)

// ---------- screen (drawing is in ui.cpp) ----------
// Anti-ghosting tweak: the ideal common voltage (VCOM) varies from panel to panel. Off the sweet spot, a DC
// current is left in the liquid crystal and an image held still for hours gets burned in ("ghost"). The panel
// shows a pattern that shimmers when the VCOM is wrong; the user adjusts until it stops and saves.
void applyVcom(uint8_t v) { tft.sendCommand(0xBB, &v, 1); }
uint32_t vcomTestUntil = 0;  // on-screen test until this millis()
uint8_t vcomTest = UI_VCOM_DEFAULT;     // value under test (applied, not yet saved)
int8_t vcomDraw = 0;         // 2 = draw the whole pattern, 1 = just the value
// Colour order, inversion and rotation vary between units of the SmallTV: all configurable in the panel.
// Vertical hardware scrolling (VSCRDEF 0x33 / VSCSAD 0x37), used by uiScroll* in ui.cpp.
// The ST7789's RAM has 320 rows and the 240 glass shows the first 240 the panel READS (displayed row n
// shows RAM row n + VSCSAD). Where the rows the library writes end up in RAM:
//   normal (setRotation(2), MADCTL without MY): row address = y, y = 0..239 -> RAM 0..239; the margin
//     (80 rows with no glass) is address 240..319.
//   rotated (setRotation(0), MADCTL MX|MY): address = y + 80, and MY mirrors the RAM (RAM = 319 - address),
//     so y = 0..239 -> RAM 239..0 and the margin is address 0..79 (RAM 319..240).
// MY only mirrors write access; VSCSAD is still in displayed rows. So, for the content to move up
// from the viewer's point of view, rotated needs VSCSAD = rows - offset (uiScrollSad in ui.h). The chip scrolls the
// whole area at once: here TFA = BFA = 0 and VSA = rows (the fixed bands don't fit, see ui.h).
// In either case, drawing's y = 0..239 stays the same address during the scroll.
static int16_t scrollDef = 0;  // VSA sent last (0 = not yet)
static void tftScroll(int16_t rows, int16_t offset) {
  int16_t r = rows ? rows : 320;
  if (r != scrollDef) {
    uint8_t d[6] = {0, 0, (uint8_t)(r >> 8), (uint8_t)r, (uint8_t)((320 - r) >> 8), (uint8_t)(320 - r)};
    tft.sendCommand(0x33, d, 6);
    scrollDef = r;
  }
  uint16_t sad = uiScrollSad(cfg.flip, r, offset);
  uint8_t a[2] = {(uint8_t)(sad >> 8), (uint8_t)sad};
  tft.sendCommand(0x37, a, 2);
}
// Blacks out the RAM margin (80 rows beyond the glass). It's never drawn after this: it only shows
// during a scroll, and the RAM's old contents (garbage after power-on) would show in the gap.
static void tftClearMargin() {
  uint16_t a0 = cfg.flip ? 0 : 240;  // row addresses of the margin, without the library's offset
  uint8_t ca[4] = {0, 0, 0, 239}, ra[4] = {(uint8_t)(a0 >> 8), (uint8_t)a0, (uint8_t)((a0 + 79) >> 8), (uint8_t)(a0 + 79)};
  tft.sendCommand(ST77XX_CASET, ca, 4);
  tft.sendCommand(ST77XX_RASET, ra, 4);
  tft.startWrite();
  tft.writeCommand(ST77XX_RAMWR);
  tft.writeColor(0, 240UL * 80);
  tft.endWrite();
}
void applyPanel() {
  uiScrollEnd();
  tft.setRotation(cfg.flip ? 0 : 2);  // Adafruit: 2 = no mirroring/offsets 0; 0 = 180° (offset 80 already handled)
  uint8_t madctl = (cfg.flip ? (ST77XX_MADCTL_MX | ST77XX_MADCTL_MY) : 0) | (cfg.bgr ? 0x08 : 0);
  tft.sendCommand(ST77XX_MADCTL, &madctl, 1);
  tft.invertDisplay(cfg.invert);
  tft.fillScreen(0);
  tftClearMargin();
  uiInvalidate();
}

void checkDayRollover(const struct tm &t) {
  if (t.tm_yday == cfg.todayYday) return;
  // on the first sync it only records the day, without resetting what's already been done
  if (cfg.todayYday >= 0) cfg.todayCount = 0;
  cfg.todayYday = t.tm_yday;
  saveSettings();
  statsRollover(t);
}

// "14:05" for the web panel
String hhmm(const struct tm &t) {
  int h = t.tm_hour;
  if (cfg.hour12) h = h % 12 == 0 ? 12 : h % 12;
  char buf[8];
  snprintf(buf, sizeof(buf), "%02d:%02d", h, t.tm_min);
  return buf;
}

char ipText[16];

UiState makeState() {
  UiState s;
  memset(&s, 0, sizeof s);
  s.timeOk = localNow(s.now);
  s.hour12 = cfg.hour12;
  s.phase = phase;
  s.running = running;
  s.remainingMs = remainingMs;
  s.totalMs = totalMs;
  s.cycleDone = cycleDone;
  s.longEvery = cfg.longEvery;
  s.today = cfg.todayCount;
  s.dailyGoal = cfg.dailyGoal;
  s.activity = cfg.activity;
  s.streak = statsStreak;
  s.best = statsBest;
  s.weatherOn = cfg.weatherOn && cfg.city[0];
  s.wx = {wx.ok, wx.t, wx.tmin, wx.tmax, wx.hum, wx.code, wx.day, wx.version, wx.nd, {}, (uint8_t)(cfg.rainAlert ? wx.rainIn : 0), wx.wind, wx.gust, wx.wdir};
  memcpy(s.wx.d, wx.d, sizeof wx.d);
  s.wx.feels = wx.feels;
  s.wx.uv10 = wx.uv10;
  s.wx.aqi = wx.aqi;
  s.wx.uvMax10 = wx.uvMax10;
  s.wx.pm25 = wx.pm25;
  s.wx.pm10 = wx.pm10;
  s.wx.rise = sunRise;
  s.wx.set = sunSet;
  s.wx.nh = wx.nh;
  s.wx.h0 = wx.h0;
  memcpy(s.wx.ht, wx.ht, sizeof wx.ht);
  memcpy(s.wx.hp, wx.hp, sizeof wx.hp);
  s.fahr = cfg.fahr;
  if (s.fahr) {  // °F only on the screen: the weather is still stored in °C
    auto f = [](float c) { return c * 9 / 5 + 32; };
    s.wx.t = f(s.wx.t);
    s.wx.tmin = f(s.wx.tmin);
    s.wx.tmax = f(s.wx.tmax);
    s.wx.feels = f(s.wx.feels);
    for (int i = 0; i < s.wx.nh; i++) s.wx.ht[i] = (int8_t)constrain(lroundf(f(s.wx.ht[i])), -99, 127);
    for (UiDay &d : s.wx.d) {
      d.tmin = (int8_t)constrain(lroundf(f(d.tmin)), -99, 127);
      d.tmax = (int8_t)constrain(lroundf(f(d.tmax)), -99, 127);
    }
  }
  s.city = cfg.city;
  s.theme = previewActive() ? previewTheme : cfg.theme;
  s.accent = clockColor();
  strlcpy(ipText, WiFi.localIP().toString().c_str(), sizeof ipText);
  s.ip = ipText;
  s.ms = millis();
  s.celebrate = alertUntil != 0;
  s.south = cfg.lat < 0;
  s.lat = cfg.lat;
  s.lon = cfg.lon;
  s.utc = s.timeOk ? (uint32_t)time(nullptr) : 0;  // a phase just finished: end animation on the Pomodoro
  return s;
}

// Time of the last full screen change (the first drawing after uiInvalidate or a screen change),
// to compare 40 and 80 MHz on the real clock; shows in diag.draw.
uint16_t fullDrawMs = 0;
struct DrawProbe {
  uint32_t n0 = uiEnters, t0 = millis();
  ~DrawProbe() {
    if (uiEnters != n0) fullDrawMs = min<uint32_t>(millis() - t0, 65535);
  }
};

void renderClock() {
  DrawProbe probe;
  // weatherbox: first install, already on Wi-Fi but with no city: a screen with a QR code to open the panel
  static bool citySetup = false;
  if (WiFi.status() == WL_CONNECTED && !cfg.city[0]) {
    if (!citySetup) {
      citySetup = true;
      uiSetupCity(WiFi.localIP().toString().c_str(), lanName[0] ? lanName : netName);
    }
    return;
  }
  if (citySetup) {
    citySetup = false;
    uiInvalidate();
  }
  UiState s = makeState();
  if (!s.timeOk) {  // no time yet: never looks frozen
    syncHintOn = true;
    uiRenderClock(s);
    uiSyncHint(s.ms);
    return;
  }
  if (syncHintOn) {  // the time arrived: remove the indicator by redrawing the face
    syncHintOn = false;
    uiInvalidate();
  }
  if (s.timeOk && timeTrusted()) {  // day rollover and history only with a confirmed time
    checkDayRollover(s.now);
    statsFlush(s.now);
    s.today = cfg.todayCount;
  }
  uiRenderClock(s);
}

// How long the screen takes to draw the whole Pomodoro on entry (ring and numbers): the panel holds the starting
// time for that long, so both sets of numbers start counting down together (see "pdraw" in /api/state).
bool pomoShown = false;
uint16_t pomoDrawMs = 0;
void renderPomodoro() {
  DrawProbe probe;
  uint32_t t0 = millis();
  uint16_t seq = phaseSeq;  // the phase this drawing shows (the command may arrive during the drawing)
  uiRenderPomodoro(makeState());
  shownSeq = seq;
  if (!pomoShown) {
    pomoShown = true;
    pomoDrawMs = millis() - t0;
  }
}

void renderAlert() {
  // flashes the screen by toggling colour inversion
  bool flash = (millis() / 250) % 2 == 0;
  tft.invertDisplay(flash ? !cfg.invert : cfg.invert);
}

void message(const char *a, const char *b = "", const char *c = "", const char *d = "") { uiMessage(a, b, c, d); }

// Start-up screen bar: done = steps completed (0 Wi-Fi, 1 time, 2 ready); animates every ~60 ms
void bootAnim(uint8_t done) {
  static uint32_t last = 0;
  uint32_t now = millis();
  if (now - last < 60) return;
  last = now;
  uiBootProgress(now, done);
}

uint32_t colorTestUntil = 0;

// ---------- face rotation ----------
// List "t:1,p:bento,..." (built-in by number, pack by id) in /rotation.txt; every cfg.rotMin
// minutes, with the clock idle (no Pomodoro or preview), it moves to the next. The change isn't written to
// EEPROM (that would be a write on every change): whatever is saved applies after a restart.
String rotList;
uint32_t rotNext = 0;
bool rotStepNow = false;  // weatherbox: scheduleView asks for the next face when leaving the album
void rotSet(const String &v);
void rotLoop();

// ---------- album: photos (JPG) and GIFs on LittleFS ----------
bool fsOk = false;

// The _FS_start symbol comes from the linker script of the chosen layout (eagle.flash.4m2m.ld: 0x40400000).
bool fsLayout2() { return (uint32_t)&_FS_start == 0x40400000; }

// Mounts LittleFS WITHOUT formatting needlessly: if it fails, the files stay intact. The exception is migrating from the
// 4M3M layout (LittleFS at 0x100000) to 4M2M (0x200000): on the first boot here, with no mark in
// EEPROM, what sits at 0x200000 is a piece of the old file system (or of the original firmware's
// storage), so it formats once, recreates the folders and sets `pend` so the panel offers to restore
// the backup. If the mark exists and mounting fails, it does NOT format (it could be something else): the panel shows the Format button.
void fsMount() {
  LittleFSConfig fcfg;
  fcfg.setAutoFormat(false);
  LittleFS.setConfig(fcfg);
  fsOk = LittleFS.begin();
  if (!fsLayout2()) return;
  EEPROM.get(FS_OFF, fsMark);
  if (fsMark.magic == FS_MAGIC) return;
  message("Weather Clock", tr("Reorganizando a memoria", "Reorganizing storage", "Reorganizando la memoria"), "...");
  if (fsOk) LittleFS.end();
  // Before formatting, it saves the history, rotation and notices, which are worth more than the space they take: on the first
  // boot the old LittleFS (4M3M, 0x100000-0x3FA000) is still intact, because the update only wrote below
  // 0x100000. That way anyone updating without the panel backup (e.g. straight from 1.23.1) doesn't lose their streak.
  struct Keep { const char *path; std::unique_ptr<uint8_t[]> data; size_t len; } keep[] = {
      {"/stats.bin", nullptr, 0}, {"/rotation.txt", nullptr, 0}, {"/hooks.txt", nullptr, 0}};
  {
    FS old(FSImplPtr(new littlefs_impl::LittleFSImpl(0x100000, 0x3FA000 - 0x100000, 256, 8192, 2)));
    if (old.begin()) {
      for (Keep &k : keep) {
        File f = old.open(k.path, "r");
        if (!f || !f.size() || f.size() > 2048) continue;
        k.data.reset(new (std::nothrow) uint8_t[f.size()]);
        if (k.data) k.len = f.read(k.data.get(), f.size());
      }
      old.end();
    }
  }
  fsOk = LittleFS.format() && LittleFS.begin();
  if (!fsOk) return;  // no mark: try again on the next boot
  LittleFS.mkdir("/image");
  LittleFS.mkdir("/gif");
  LittleFS.mkdir("/faces");
  for (Keep &k : keep) {
    if (!k.len) continue;
    File f = LittleFS.open(k.path, "w");
    if (f) f.write(k.data.get(), k.len);
  }
  fsMark = {FS_MAGIC, 1};
  EEPROM.put(FS_OFF, fsMark);
  EEPROM.commit();
}
void sendStats();
void setupUpdate();

// ---------- focus history (/stats.bin) ----------
// One counter per day in a ring of 371 days (53 weeks): gives the streak of days with the goal reached,
// the record and the panel's garden. Only the header stays in RAM; the days are read from the file.
struct StatsHead { uint32_t magic; uint16_t lastDay, best; uint32_t total; };
const uint32_t STATS_MAGIC = 0x544F4D31;  // "TOM1"
const uint16_t STATS_DAYS = 371;
StatsHead stats = {0, 0, 0, 0};
uint16_t statsStreak = 0, statsBest = 0;
bool statsWritePending = false;
uint16_t statsPendingDay = 0;
uint8_t statsPendingCount = 0;
bool fsWriterBusy();
void statsFlush(void);

// days since 1970-01-01 for the local date ("days from civil" algorithm)
uint16_t dayNumber(const struct tm &t) {
  int y = t.tm_year + 1900, m = t.tm_mon + 1;
  y -= m <= 2;
  int era = y / 400, yoe = y - era * 400, doy = (153 * (m + (m > 2 ? -3 : 9)) + 2) / 5 + t.tm_mday - 1;
  return era * 146097 + yoe * 365 + yoe / 4 - yoe / 100 + doy - 719468;
}

// reads the 371 days in order (oldest first); false with no file
bool statsRead(uint8_t *days) {
  File f = fsOk ? LittleFS.open("/stats.bin", "r") : File();
  if (!f || f.size() != sizeof(StatsHead) + STATS_DAYS) return false;
  uint8_t ring[STATS_DAYS];
  f.seek(sizeof(StatsHead));
  f.read(ring, STATS_DAYS);
  f.close();
  for (int i = 0; i < STATS_DAYS; i++) days[i] = ring[(stats.lastDay + 1 + i) % STATS_DAYS];
  return true;
}

void statsCompute() {
  uint8_t d[STATS_DAYS];
  statsStreak = 0;
  if (stats.magic == STATS_MAGIC && statsRead(d)) {
    int i = STATS_DAYS - 1;
    if (d[i] < cfg.dailyGoal) i--;  // today hasn't reached it yet: the streak runs up to yesterday
    for (; i >= 0 && d[i] >= cfg.dailyGoal; i--) statsStreak++;
  }
  if (statsStreak > stats.best) stats.best = statsStreak;
  statsBest = stats.best;
}

// writes day "day" with "count" sessions, zeroing the days skipped since the last record
void statsWrite(uint16_t day, uint8_t count) {
  if (!fsOk) return;
  // LittleFS 2.5.1 can corrupt data with two files open for writing. An upload stays
  // open between handleClient() calls, so only the latest history update is kept
  // and written after the upload ends.
  if (fsWriterBusy()) {
    statsPendingDay = day;
    statsPendingCount = count;
    statsWritePending = true;
    return;
  }
  File f = LittleFS.open("/stats.bin", "r+");
  bool fresh = !f || f.size() != sizeof(StatsHead) + STATS_DAYS;  // no file (or formatted storage)
  if (fresh) {
    if (f) f.close();
    f = LittleFS.open("/stats.bin", "w+");
  }
  if (!f) return;
  if (!fresh && stats.magic == STATS_MAGIC && day < stats.lastDay) {  // the time went backwards: erase nothing
    f.close();
    return;
  }
  if (fresh || stats.magic != STATS_MAGIC || day - stats.lastDay >= STATS_DAYS) {
    if (stats.magic != STATS_MAGIC) stats = {STATS_MAGIC, day, 0, 0};
    // header and the 371 days in sequence from the start: LittleFS doesn't allow seeking past the end
    // of the file (the seek fails). Up to 1.18.2 this code skipped the header in an empty file, the file
    // ended up at 371 bytes and the next boot threw the history away (see statsLoad).
    uint8_t zero[64] = {0};
    f.seek(0);
    f.write((const uint8_t *)&stats, sizeof stats);
    for (int i = 0; i < STATS_DAYS; i += sizeof zero) f.write(zero, min((int)sizeof zero, STATS_DAYS - i));
  } else
    for (uint16_t d = stats.lastDay + 1; d < day; d++) {  // days with the clock switched off: zero
      f.seek(sizeof(StatsHead) + d % STATS_DAYS);
      f.write((uint8_t)0);
    }
  f.seek(sizeof(StatsHead) + day % STATS_DAYS);
  f.write(count);
  stats.lastDay = day;
  f.seek(0);
  f.write((const uint8_t *)&stats, sizeof stats);
  f.close();
}

// history (oldest first) for the garden, the achievements, the share card and the backup
void sendStats() {
  if (!readOk()) return;
  uint8_t d[STATS_DAYS];
  bool ok = stats.magic == STATS_MAGIC && statsRead(d);
  String j;
  j.reserve(STATS_DAYS * 3 + 96);
  j = F("{\"day\":");
  j += stats.lastDay;
  j += F(",\"goal\":");
  j += cfg.dailyGoal;
  j += F(",\"streak\":");
  j += statsStreak;
  j += F(",\"best\":");
  j += statsBest;
  j += F(",\"total\":");
  j += stats.total;
  j += F(",\"days\":[");
  for (int i = 0; i < STATS_DAYS; i++) {
    if (i) j += ',';
    j += ok ? d[i] : 0;
  }
  j += "]}";
  server.send(200, "application/json", j);
}

void statsLoad() {
  File f = fsOk ? LittleFS.open("/stats.bin", "r") : File();
  size_t n = f ? f.size() : 0;
  if (n == sizeof(StatsHead) + STATS_DAYS) f.read((uint8_t *)&stats, sizeof stats);
  else if (n >= STATS_DAYS && n < sizeof(StatsHead) + STATS_DAYS) {
    // short file written up to 1.18.2 (see statsWrite): same header and the days from byte 12,
    // only with the end missing. Recovers what's there and rewrites it at the right size.
    uint8_t ring[STATS_DAYS] = {0};
    f.read((uint8_t *)&stats, sizeof stats);
    f.read(ring, n - sizeof(StatsHead));
    f.close();
    File w = stats.magic == STATS_MAGIC ? LittleFS.open("/stats.bin", "w") : File();
    if (w) {
      w.write((const uint8_t *)&stats, sizeof stats);
      w.write(ring, STATS_DAYS);
      w.close();
    }
  }
  if (f) f.close();
  if (stats.magic != STATS_MAGIC) stats = {0, 0, 0, 0};
  statsCompute();
}

void statsFocus() {
  struct tm t;
  if (!localNow(t) || !timeTrusted()) {  // no confirmed time: keep it and write it once confirmed (statsFlush)
    if (statsPending < 255) statsPending++;
    return;
  }
  stats.total++;
  statsWrite(dayNumber(t), cfg.todayCount > 255 ? 255 : cfg.todayCount);
  if (!statsWritePending) statsCompute();
}

void statsFlush(const struct tm &t) {
  if (!statsPending) return;
  stats.total += statsPending;
  statsPending = 0;
  statsWrite(dayNumber(t), cfg.todayCount > 255 ? 255 : cfg.todayCount);
  statsCompute();
}

void statsRollover(const struct tm &t) {
  statsWrite(dayNumber(t), cfg.todayCount > 255 ? 255 : cfg.todayCount);
  if (!statsWritePending) statsCompute();
}
std::vector<String> album;
size_t albumIdx = 0;
bool inAlbum = false;
uint32_t viewUntil = 0;
String curFile;
AnimatedGIF *gif = nullptr;
File wcrFile;
bool wcrOn = false;
uint8_t wcrFrames = 0, wcrFrame = 0;
uint16_t wcrDelay[32];
uint32_t wcrData = 0;   // position of the first frame in the file
uint32_t wcrData1 = 0;  // position of the second frame (the loop goes back to it)
bool wcrWrap = false;   // the last frame turns the last back into the first: the loop doesn't redraw everything

// Reads and checks the header; leaves the file at the first frame
bool wcrOpen(File &f, uint8_t &frames, uint16_t *delays, uint32_t &data) {
  uint8_t h[10];
  if (!f || f.read(h, 10) != 10 || memcmp(h, "WCR2", 4)) return false;
  const uint16_t w = h[4] | h[5] << 8, ht = h[6] | h[7] << 8;
  frames = h[8];
  if (w != 240 || ht != 240 || !frames || frames > 32) return false;
  for (int i = 0; i < frames; i++) {
    uint8_t d[2];
    if (f.read(d, 2) != 2) return false;
    delays[i] = d[0] | d[1] << 8;
  }
  data = 10 + 2 * frames;
  return true;
}

bool validWcr(const String &path) {
  File f = LittleFS.open(path, "r");
  uint8_t n;
  uint16_t d[32];
  uint32_t data;
  const bool ok = wcrOpen(f, n, d, data) && f.size() > data + 4;
  f.close();
  return ok;
}

extern int16_t gifMaskX, gifMaskY;
// One frame: records n < 0x80 = n pixels of the following colour (RGB565); n >= 0x80 = (n & 0x7F) + 1 pixels that
// stay as they are (the previous frame). Builds row spans and sends each span finished (no flicker).
bool wcrDrawFrame() {
  uint8_t lb[4];
  if (wcrFile.read(lb, 4) != 4) return false;
  uint32_t left = lb[0] | lb[1] << 8 | (uint32_t)lb[2] << 16 | (uint32_t)lb[3] << 24;
  uint8_t in[192];
  int have = 0, pos = 0;
  auto next = [&](int &b) -> bool {
    if (pos == have) {
      if (!left) return false;
      have = wcrFile.read(in, left < sizeof in ? left : sizeof in);
      if (have <= 0) return false;
      left -= have;
      pos = 0;
    }
    b = in[pos++];
    return true;
  };
  uint16_t *row = uiRowBuf();
  int x = 0, y = 0, span = -1;  // span: start of the painted span not yet sent
  auto flush = [&]() {
    if (span < 0) return;
    int end = x;
    if (y >= gifMaskY && end > gifMaskX) end = gifMaskX;  // the radar's clock corner is left out
    if (end > span) {
      tft.setAddrWindow(span, y, end - span, 1);
      tftPixels(row + span, end - span);
    }
    span = -1;
  };
  tft.startWrite();
  int n, lo, hi;
  while (y < 240 && next(n)) {
    if (n & 0x80) {  // skip: keep what's already on screen
      int k = (n & 0x7F) + 1;
      while (k > 0 && y < 240) {
        flush();
        const int step = k < 240 - x ? k : 240 - x;
        x += step;
        k -= step;
        if (x == 240) { x = 0; y++; }
      }
      continue;
    }
    if (!next(lo) || !next(hi)) break;
    const uint16_t c = lo | hi << 8;
    while (n > 0 && y < 240) {
      if (span < 0) span = x;
      const int step = n < 240 - x ? n : 240 - x;
      for (int j = 0; j < step; j++) row[x + j] = c;
      x += step;
      n -= step;
      if (x == 240) {
        flush();
        x = 0;
        y++;
      }
    }
    if ((y & 15) == 0) yield();
  }
  flush();
  tft.endWrite();
  if (left) wcrFile.seek(wcrFile.position() + left);
  return y == 240;
}
File mediaFile;
int gifOffX = 0, gifOffY = 0;
uint32_t nextFrameAt = 0;

bool endsWithIgnoreCase(const String &s, const char *suffix) {
  size_t n = s.length(), m = strlen(suffix);
  if (m > n) return false;
  for (size_t i = 0; i < m; i++) {
    char a = s[n - m + i];
    if (a >= 'A' && a <= 'Z') a += 'a' - 'A';
    if (a != suffix[i]) return false;
  }
  return true;
}
bool isGif(const String &n) { return endsWithIgnoreCase(n, ".gif"); }
bool isJpg(const String &n) { return endsWithIgnoreCase(n, ".jpg") || endsWithIgnoreCase(n, ".jpeg"); }
// weatherbox: animation already in pixels (.wcr, made by the radar program). Header "WCR1", width and height
// (u16), frames (u8), 1 spare byte and each frame's delay in ms (u16); then, per frame, the size (u32)
// and pairs (repeats u8, RGB565 colour u16). Goes from the file to the screen row by row: ~1 KB of RAM, without the
// GIF decoder (24 KB), so it doesn't depend on memory being in one piece.
bool isWcr(const String &n) { return endsWithIgnoreCase(n, ".wcr"); }

// Folders used by the original firmware: /image (photos and GIFs) and /gif.
const char *MEDIA_DIRS[] = {"/image", "/gif"};

uint32_t fsInfoAt = 0;  // when the free space was measured for the panel (0 = measure again)

void rebuildAlbum() {
  fsInfoAt = 0;  // photos uploaded, deleted or formatted: the free space changed
  album.clear();
  if (!fsOk) return;
  for (const char *dir : MEDIA_DIRS) {
    Dir d = LittleFS.openDir(dir);
    while (d.next()) {
      if (d.isDirectory()) continue;
      String n = String(dir) + "/" + d.fileName();
      // the original firmware's boot animation doesn't go in the album
      if ((isJpg(n) || isGif(n) || isWcr(n)) && d.fileName() != "boot.gif" && d.fileName() != "boot.jpg") album.push_back(n);
    }
  }
}

// File callbacks shared by the GIF and JPEG decoders (same author, same API).
void *mediaOpen(const char *fn, int32_t *size) {
  mediaFile = LittleFS.open(fn, "r");
  if (!mediaFile) return nullptr;
  *size = mediaFile.size();
  return &mediaFile;
}
void mediaClose(void *) {
  if (mediaFile) mediaFile.close();
}

int32_t jpgRead(JPEGFILE *f, uint8_t *buf, int32_t len) {
  yield();
  File *fl = (File *)f->fHandle;
  int32_t n = len;
  if (f->iSize - f->iPos < len) n = f->iSize - f->iPos;
  if (n <= 0) return 0;
  n = fl->read(buf, n);
  f->iPos = fl->position();
  return n;
}
int32_t jpgSeek(JPEGFILE *f, int32_t pos) {
  File *fl = (File *)f->fHandle;
  if (pos < 0 || pos > f->iSize || !fl->seek(pos)) return -1;
  f->iPos = fl->position();
  return f->iPos;
}
int jpgDraw(JPEGDRAW *p) {
  if (p->y >= 240) return 0;
  if (!uiClip.on) {
    tftBitmap(p->x, p->y, p->pPixels, p->iWidth, p->iHeight);
    return 1;
  }
  blit(p->x, p->y, p->pPixels, p->iWidth, p->iHeight);  // clips to the dirty area; off-screen, it lands in the strip
  return 1;
}

const int MAX_JPEG_DIM = 1920;  // maximum scale 1/8: never hands more than 240 px to the display
bool jpgDimensionsOk(JPEGDEC *jpg) {
  return jpg->getWidth() > 0 && jpg->getHeight() > 0 && jpg->getWidth() <= MAX_JPEG_DIM && jpg->getHeight() <= MAX_JPEG_DIM;
}
int jpgCheckDraw(JPEGDRAW *) {
  yield();
  return 1;
}
bool validJpg(const String &path) {
  JPEGDEC *jpg = new (std::nothrow) JPEGDEC();
  if (!jpg) return false;
  bool opened = jpg->open(path.c_str(), mediaOpen, mediaClose, jpgRead, jpgSeek, jpgCheckDraw);
  bool ok = false;
  if (opened && jpgDimensionsOk(jpg)) {
    int sc = 1;
    while (sc < 8 && (jpg->getWidth() / sc > 240 || jpg->getHeight() / sc > 240)) sc *= 2;
    int opt = sc == 2 ? JPEG_SCALE_HALF : sc == 4 ? JPEG_SCALE_QUARTER : sc == 8 ? JPEG_SCALE_EIGHTH : 0;
    jpg->setPixelType(RGB565_LITTLE_ENDIAN);
    ok = jpg->decode(0, 0, opt);
  }
  jpg->close();
  delete jpg;
  return ok;
}

// The packs' "image" layer: JPEG in /faces/<file>, at point (x, y), unscaled.
bool drawJpgAt(const char *file, int x, int y) {
  String path = String("/faces/") + file;
  if (strstr(file, "..") || !LittleFS.exists(path)) return false;
  JPEGDEC *jpg = new (std::nothrow) JPEGDEC();
  if (!jpg) return false;
  bool ok = false;
  if (jpg->open(path.c_str(), mediaOpen, mediaClose, jpgRead, jpgSeek, jpgDraw) && jpgDimensionsOk(jpg)) {
    jpg->setPixelType(RGB565_LITTLE_ENDIAN);
    ok = jpg->decode(x, y, 0);
  }
  jpg->close();
  delete jpg;
  return ok;
}

bool drawJpg(const String &f) {
  JPEGDEC *jpg = new (std::nothrow) JPEGDEC();  // ~18 KB: only exists during decoding
  if (!jpg) return false;
  bool ok = false;
  if (jpg->open(f.c_str(), mediaOpen, mediaClose, jpgRead, jpgSeek, jpgDraw) && jpgDimensionsOk(jpg)) {
    int w = jpg->getWidth(), h = jpg->getHeight(), sc = 1;
    while (sc < 8 && (w / sc > 240 || h / sc > 240)) sc *= 2;
    int opt = sc == 2 ? JPEG_SCALE_HALF : sc == 4 ? JPEG_SCALE_QUARTER : sc == 8 ? JPEG_SCALE_EIGHTH : 0;
    jpg->setPixelType(RGB565_LITTLE_ENDIAN);
    ok = jpg->decode(max(0, (240 - w / sc) / 2), max(0, (240 - h / sc) / 2), opt);
  }
  jpg->close();
  delete jpg;
  return ok;
}
int32_t gifRead(GIFFILE *f, uint8_t *buf, int32_t len) {
  yield();  // including files that spend a long time in LZW codes without producing pixels
  File *fl = (File *)f->fHandle;
  int32_t n = len;
  if (f->iSize - f->iPos < len) n = f->iSize - f->iPos;
  if (n <= 0) return 0;
  n = fl->read(buf, n);
  f->iPos = fl->position();
  return n;
}
int32_t gifSeek(GIFFILE *f, int32_t pos) {
  File *fl = (File *)f->fHandle;
  fl->seek(pos);
  f->iPos = fl->position();
  return f->iPos;
}

static int gifCheckRead(void *ctx, uint8_t *buf, int n) {
  yield();  // the full check of a big file must not trigger the watchdog
  return ((File *)ctx)->read(buf, n);
}

static bool validGif(const String &path) {
  File file = LittleFS.open(path, "r");
  if (!file) return false;
  const char *error = gifCheck(gifCheckRead, &file, 480, 480);
  file.close();
  return error == nullptr;
}

// weatherbox: corner reserved for the radar clock (the GIF doesn't draw there, so it doesn't flicker)
int16_t gifMaskX = 240, gifMaskY = 240;
char cornerHM[8] = "";

void gifDraw(GIFDRAW *p) {
  uint16_t *buf = uiRowBuf();  // aligned: tftPixels doesn't copy
  int y = p->iY + p->y + gifOffY;
  if (y < 0 || y >= 240) return;
  int x0 = p->iX + gifOffX;
  int w = p->iWidth;
  if (x0 + w > 240) w = 240 - x0;
  if (y >= gifMaskY && x0 + w > gifMaskX) w = gifMaskX - x0;
  if (w <= 0) return;
  uint8_t *s = p->pPixels;
  uint16_t *pal = p->pPalette;
  if (p->ucDisposalMethod == 2) {  // restore the background
    for (int i = 0; i < w; i++)
      if (s[i] == p->ucTransparent) s[i] = p->ucBackground;
    p->ucHasTransparency = 0;
  }
  tft.startWrite();
  if (p->ucHasTransparency) {
    uint8_t tr = p->ucTransparent;
    int x = 0;
    while (x < w) {
      while (x < w && s[x] == tr) x++;
      int start = x, n = 0;
      while (x < w && s[x] != tr) buf[n++] = pal[s[x++]];
      if (n) {
        tft.setAddrWindow(x0 + start, y, n, 1);
        tftPixels(buf, n);
      }
    }
  } else {
    for (int i = 0; i < w; i++) buf[i] = pal[s[i]];
    tft.setAddrWindow(x0, y, w, 1);
    tftPixels(buf, w);
  }
  tft.endWrite();
}

// weatherbox: a face pack takes about 8 KB of RAM, and the GIF decoder (~24 KB contiguous) or the
// JPEG one (~18 KB) doesn't fit beside it. While the album is showing, the pack leaves RAM and comes back afterwards.
bool loadPack(const String &id);
static String packHeld;
static void packHold() {
  if (packHeld.length() || !facePackId()[0]) return;
  packHeld = facePackId();
  facePackUnload();
}
static void packResume() {
  if (!packHeld.length()) return;
  String id = packHeld;
  packHeld = "";
  loadPack(id);
}

void stopAlbum() {
  if (gif) {
    gif->close();
    delete gif;
    gif = nullptr;
  }
  if (wcrOn) {
    wcrFile.close();
    wcrOn = false;
  }
  inAlbum = false;
  curFile = "";
  gifMaskX = gifMaskY = 240;
  cornerHM[0] = 0;
  packResume();
  uiInvalidate();  // the clock redraws everything when it comes back
}

// weatherbox: memory fragments over the hours (the face pack comes and goes on every change) and the GIF
// can no longer find ~24 KB contiguous. In that case the clock restarts by itself, at most once per hour of use.
uint32_t memRestartAt = 0;

bool showAlbumItem(const String &f) {
  stopAlbum();
  if (!LittleFS.exists(f)) return false;
  if (!isWcr(f)) packHold();  // the .wcr uses almost no memory: the face can stay loaded
  tft.fillScreen(0);
  uiInvalidate();
  inAlbum = true;
  curFile = f;
  if (isWcr(f)) {
    wcrFile = LittleFS.open(f, "r");
    if (!wcrOpen(wcrFile, wcrFrames, wcrDelay, wcrData)) {
      wcrFile.close();
      uiError(tr("Arquivo invalido", "Invalid file", "Archivo invalido"));
      return false;
    }
    wcrOn = true;
    wcrFrame = 0;
    wcrData1 = 0;
    {
      uint8_t hb[10];
      File h = LittleFS.open(f, "r");
      wcrWrap = h && h.read(hb, 10) == 10 && hb[9] == 1 && wcrFrames > 2;
      h.close();
    }
    nextFrameAt = 0;
    return true;
  }
  if (isGif(f)) {
    if (!validGif(f)) {
      uiError(tr("GIF fora do padrao", "Unsupported GIF", "GIF fuera de norma"));
      return false;
    }
    gif = new (std::nothrow) AnimatedGIF();  // ~8 KB here + two 8 KB tables in begin()
    if (gif) gif->begin(GIF_PALETTE_RGB565_LE);
    if (gif && !gif->ready()) {
      delete gif;
      gif = nullptr;
    }
    if (!gif) {
      uiError(tr("Sem memoria p/ GIF", "No memory for GIF", "Sin memoria p/ GIF"));
      if (millis() > 3600000UL && !memRestartAt) memRestartAt = millis() | 1;
      return true;  // keeps the warning screen until the next item
    }
    if (!gif->open(f.c_str(), mediaOpen, mediaClose, gifRead, gifSeek, gifDraw)) {
      gif->close();
      delete gif;
      gif = nullptr;
      uiError(tr("GIF invalido", "Invalid GIF", "GIF invalido"));
      return false;
    }
    gifOffX = max(0, (240 - gif->getCanvasWidth()) / 2);
    gifOffY = max(0, (240 - gif->getCanvasHeight()) / 2);
    nextFrameAt = 0;
  } else {
    if (!drawJpg(f)) uiError(tr("JPG invalido", "Invalid JPG", "JPG invalido"));
  }
  return true;
}

void albumLoop() {
  if ((!gif && !wcrOn) || (int32_t)(millis() - nextFrameAt) < 0) return;
  if (wcrOn) {
    if (!wcrDrawFrame()) {
      stopAlbum();
      return;
    }
    nextFrameAt = millis() + max((int)wcrDelay[wcrFrame], 20);
    if (wcrFrame == 0 && !wcrData1) wcrData1 = wcrFile.position();
    if (++wcrFrame >= wcrFrames) {  // end: with the wrap frame, carry on from the second; otherwise from the first
      if (wcrWrap && wcrData1) {
        wcrFrame = 1;
        wcrFile.seek(wcrData1);
      } else {
        wcrFrame = 0;
        wcrFile.seek(wcrData);
      }
    }
  } else {
    int delayMs = 0;
    int r = gif->playFrame(false, &delayMs);
    if (r < 0) {  // error: give up on this GIF
      stopAlbum();
      return;
    }
    if (r == 0) gif->reset();  // last frame: start over
    nextFrameAt = millis() + max(delayMs, 20);
  }
  // weatherbox: on the radar, the current time in the corner; the GIF doesn't draw there, so it only redraws when it changes
  struct tm t;
  if (curFile.indexOf("radar") >= 0 && localNow(t)) {
    char hm[8];
    int h = t.tm_hour;
    if (cfg.hour12) h = h % 12 == 0 ? 12 : h % 12;
    snprintf(hm, sizeof hm, "%02d:%02d", h, t.tm_min);
    if (strcmp(hm, cornerHM)) {
      strlcpy(cornerHM, hm, sizeof cornerHM);
      uiCornerClock(hm);
      gifMaskX = 240 - (int)strlen(hm) * 12 - 11;  // same box as uiCornerClock
      gifMaskY = 212;
    }
  }
}

// Decides what to show when there's no Pomodoro: the clock or an album item.
void scheduleView() {
  uint32_t now = millis();
  if (viewUntil && (int32_t)(now - viewUntil) < 0) return;
  bool wantAlbum = !album.empty() && (cfg.mode == 1 || (cfg.mode == 2 && !inAlbum));
  if (wantAlbum) {
    const String &next = album[albumIdx++ % album.size()];
    // with a single item, don't redraw the same photo (avoids flicker and restarting the GIF)
    if (!(inAlbum && next == curFile)) {
      fadeOutNow();
      showAlbumItem(next);
    }
  } else if (inAlbum) {
    fadeOutNow();
    stopAlbum();
    // weatherbox: when alternating with the album, the rotation advances here, on the way back to the clock, and not by its own
    // timer: each face and each album item stays on screen for exactly "Seconds per item"
    rotNext = millis();
    rotStepNow = true;
    rotLoop();
    rotStepNow = false;
  }
  viewUntil = now + cfg.albumDelay * 1000UL;
  if (!viewUntil) viewUntil = 1;
}

// ---------- face packs (/faces/<id>.json) ----------
bool idOk(const String &id) {
  if (!id.length() || id.length() > 23) return false;
  for (char c : id)
    if (!((c >= 'a' && c <= 'z') || (c >= '0' && c <= '9') || c == '-' || c == '_')) return false;
  return true;
}

// Reads the file and loads it into the engine. On error, msg gets the reason.
bool loadPackFile(const String &path, String &msg) {
  File f = fsOk ? LittleFS.open(path, "r") : File();
  if (!f) {
    msg = F("file not found");
    return false;
  }
  size_t n = f.size();
  if (n == 0 || n > 16384) {
    f.close();
    msg = F("face pack empty or larger than 16 KB");
    return false;
  }
  char err[96];
  bool ok = facePackLoadFile(f, err, sizeof err);  // in passes: the JSON doesn't fit in RAM whole
  f.close();
  if (!ok) msg = err;
  uiInvalidate();
  return ok;
}

bool loadPack(const String &id) {
  String msg;
  return idOk(id) && loadPackFile("/faces/" + id + ".json", msg);
}

// Puts the engine back on the pack saved in the settings (or frees it, if the active face is built-in).
void restoreActivePack() {
  if (cfg.theme == THEME_PACK && loadPack(cfg.facePkg)) return;
  facePackUnload();
  if (cfg.theme == THEME_PACK) cfg.theme = THEME_MATRIX;
  uiInvalidate();
}

File packUpload;
String packUploadError;
UploadGate packGate;
bool packFaceReady = false;

// Receives "face" (the .json) and, optionally, "preview" (the .png) into temporary files.
void handlePackUpload() {
  HTTPUpload &up = server.upload();
  if (up.status == UPLOAD_FILE_START) {
    if (packUpload) packUpload.close();
    packGate.begin(false, 0);
    if (up.name == "face") { packUploadError = ""; packFaceReady = false; }
    if (!panelOk() || !uploadAuthed()) {
      packUploadError = F("Forbidden");
      return;
    }
    if (up.name != "face" && up.name != "preview") { packUploadError = F("Invalid field"); return; }
    if (packUploadError.length()) return;
    if (!fsOk) {
      packUploadError = F("File system unavailable");
      return;
    }
    if (!LittleFS.exists("/faces")) LittleFS.mkdir("/faces");
    if (up.name == "face") { LittleFS.remove("/faces/_novo.json"); LittleFS.remove("/faces/_novo.png"); }
    packUpload = LittleFS.open(up.name == "preview" ? "/faces/_novo.png" : "/faces/_novo.json", "w");
    if (!packUpload) { packUploadError = F("Could not create the file"); return; }
    packGate.begin(true, up.name == "face" ? 16384 : 65536);
  } else if (up.status == UPLOAD_FILE_WRITE) {
    if (!packGate.active) return;
    if (!packGate.take(up.currentSize)) packUploadError = F("File too large");
    else if (packUpload.write(up.buf, up.currentSize) != up.currentSize) packUploadError = F("Storage full");
    if (packUploadError.length()) { packUpload.close(); packGate.stop(); }
  } else if (up.status == UPLOAD_FILE_END || up.status == UPLOAD_FILE_ABORTED) {
    if (packUpload) packUpload.close();
    if (up.status == UPLOAD_FILE_ABORTED) packUploadError = F("Upload interrupted");
    if (packGate.active && !packUploadError.length() && up.name == "face") packFaceReady = true;
    packGate.stop();
    if (packUploadError.length()) packFaceReady = false;
  }
}

// ---------- web ----------
void jsonEscapeAppend(String &o, const char *s) {
  for (; *s; s++) {
    char c = *s;
    if (c == '"' || c == '\\') o += '\\';
    if ((uint8_t)c >= 0x20) o += c;
  }
}

bool safeText(const String &s) { return s.indexOf('"') < 0 && s.indexOf('\\') < 0; }

// The clock's time zone offset right now, in seconds (local time - UTC), from the difference between localtime and gmtime.
int32_t localOffset() {
  time_t now = time(nullptr);
  struct tm lt, gt;
  localtime_r(&now, &lt);
  gmtime_r(&now, &gt);
  int32_t d = (lt.tm_hour - gt.tm_hour) * 3600 + (lt.tm_min - gt.tm_min) * 60;
  int dd = lt.tm_yday - gt.tm_yday;  // day (or year) rollover between the two
  if (dd == 1 || dd < -1) d += 86400;
  else if (dd == -1 || dd > 1) d -= 86400;
  return d;
}

// ---------- diagnostics (panel: Settings -> System) ----------
// Reason for the last restart (and, if it was a crash, the cause and address), Wi-Fi signal, lowest free memory
// since power-on and uptime: if the clock restarts by itself, you can see why instead of guessing.
uint32_t diagMinHeap = 0xFFFFFFFF, diagLastMs = 0;
uint16_t diagWraps = 0;  // millis() wraps to zero every ~49.7 days
void diagLoop() {
  uint32_t now = millis(), h = ESP.getFreeHeap();
  if (now < diagLastMs) diagWraps++;
  diagLastMs = now;
  if (h < diagMinHeap) diagMinHeap = h;
}
void diagJson(String &j) {
  const rst_info *r = ESP.getResetInfoPtr();
  char epc[12];
  snprintf(epc, sizeof epc, "%08x", r ? (unsigned)r->epc1 : 0u);
  j += F(",\"diag\":{\"rst\":");  // 0 power-on, 1 hardware watchdog, 2 crash, 3 watchdog, 4 requested restart, 6 button/external
  j += r ? (int)r->reason : -1;
  j += F(",\"exc\":");
  j += r ? (int)r->exccause : -1;
  j += F(",\"epc\":\"");
  j += epc;
  j += F("\",\"rssi\":");
  j += WiFi.isConnected() ? WiFi.RSSI() : 0;
  j += F(",\"minheap\":");
  j += diagMinHeap;
  j += F(",\"frag\":");
  j += ESP.getHeapFragmentation();
  j += F(",\"up\":");
  j += (uint32_t)((((uint64_t)diagWraps << 32) | millis()) / 1000);
  j += F(",\"draw\":");  // ms of the last drawing that changed the whole screen (0 = none yet)
  j += fullDrawMs;
  j += F(",\"boot\":{\"scr\":");  // ms from power-on to each step of the last boot (0 = not yet)
  j += bootScreenMs;
  j += F(",\"wifi\":");
  j += bootWifiMs;
  j += F(",\"wf\":");
  j += bootWifiPath;
  j += F(",\"time\":");
  j += bootTimeMs;
  j += F(",\"src\":");
  j += bootTimeSrc;
  j += F(",\"ntp\":");
  j += bootNtpMs;
  j += F("}}");
}

// "crash" only exists after a crash: n = how many, r = reason (like diag.rst), x/epc/va = cause and addresses
void crashJson(String &j) {
  if (!crashRec.magic) return;
  char b[112];
  snprintf(b, sizeof b, ",\"crash\":{\"n\":%u,\"r\":%u,\"x\":%u,\"epc\":\"%08x\",\"va\":\"%08x\",\"up\":%u,\"ver\":\"%.7s\"}",
           crashRec.n, crashRec.reason, crashRec.exc, (unsigned)crashRec.epc, (unsigned)crashRec.vaddr, (unsigned)crashRec.up, crashRec.ver);
  j += b;
}

void sendState() {
  if (!readOk()) return;
  struct tm t;
  String clock = localNow(t) ? hhmm(t) : "--:--";
  char color[8];
  snprintf(color, sizeof(color), "#%02x%02x%02x", cfg.colR, cfg.colG, cfg.colB);
  // LittleFS.info() walks the whole file system (~100 ms with 1.5 MB of photos) and the panel
  // asks for the state every second: that stalled the GIFs. Keep the result; recompute when the
  // files change (fsInfoAt = 0) or after 1 minute.
  static FSInfo fi = {};
  if (fsOk && (!fsInfoAt || millis() - fsInfoAt > 60000)) {
    LittleFS.info(fi);
    fsInfoAt = millis() | 1;
  }
  String j;
  j.reserve(1230 + rotList.length());  // state, settings and diagnostics: a single allocation
  j += F("{\"phase\":\"");
  j += PHASE_KEY[phase];
  j += F("\",\"running\":");
  j += running ? "true" : "false";
  j += F(",\"remaining\":");
  j += remainingMs;
  j += F(",\"total\":");
  j += totalMs;
  j += F(",\"cycle\":");
  j += cycleDone;
  j += F(",\"today\":");
  j += cfg.todayCount;
  j += F(",\"streak\":");
  j += statsStreak;
  j += F(",\"best\":");
  j += statsBest;
  j += F(",\"clock\":\"");
  j += clock;
  j += F("\",\"showing\":\"");
  jsonEscapeAppend(j, curFile.c_str());
  j += F("\",\"wx\":{\"ok\":");
  j += wx.ok ? 1 : 0;
  j += F(",\"t\":");
  appendFixed(j, wx.t, 1);
  j += F(",\"min\":");
  appendFixed(j, wx.tmin, 1);
  j += F(",\"max\":");
  appendFixed(j, wx.tmax, 1);
  j += F(",\"h\":");
  j += wx.hum;
  j += F(",\"rin\":");  // minutes until rain (0 = no rain in the next hour)
  j += wx.rainIn;
  j += F(",\"wind\":");  // weatherbox: wind in km/h, gust and direction in degrees; WMO code and day/night
  j += wx.wind;
  j += F(",\"gust\":");
  j += wx.gust;
  j += F(",\"wdir\":");
  j += wx.wdir;
  j += F(",\"feels\":");
  appendFixed(j, wx.feels, 1);
  j += F(",\"uv\":");
  j += wx.uv10 == 255 ? -1 : (int)wx.uv10;
  j += F(",\"aqi\":");
  j += wx.aqi == 0xFFFF ? -1 : (int)wx.aqi;
  j += F(",\"uvmax\":");
  j += wx.uvMax10 == 255 ? -1 : (int)wx.uvMax10;
  j += F(",\"pm25\":");
  j += wx.pm25 == 0xFFFF ? -1 : (int)wx.pm25;
  j += F(",\"pm10\":");
  j += wx.pm10 == 0xFFFF ? -1 : (int)wx.pm10;
  j += F(",\"code\":");
  j += wx.code;
  j += F(",\"day\":");
  j += wx.day ? 1 : 0;
  j += F(",\"tzn\":\"");  // the city's time zone (Open-Meteo), its offset and the clock's right now
  j += wx.tzName;
  j += F("\",\"off\":");
  j += wx.utcOff;
  j += F(",\"loff\":");
  j += localOffset();
  j += F(",\"rise\":");
  j += sunRise;
  j += F(",\"set\":");
  j += sunSet;
  j += F(",\"desc\":\"");
  j += weatherText(wx.code);
  j += F("\"},\"fs\":{\"ok\":");
  j += fsOk ? 1 : 0;
  j += F(",\"l2\":");  // 1 = 4M2M layout (the panel only offers the migration to those still on 4M3M)
  j += fsLayout2() ? 1 : 0;
  j += F(",\"mig\":");  // 1 = storage was reorganised and the backup hasn't been restored yet
  j += fsMark.magic == FS_MAGIC && fsMark.pend ? 1 : 0;
  j += F(",\"used\":");
  j += (uint32_t)fi.usedBytes;
  j += F(",\"total\":");
  j += (uint32_t)fi.totalBytes;
  j += F("},\"cfg\":{\"work\":");
  j += cfg.work;
  j += F(",\"short\":");
  j += cfg.shortBreak;
  j += F(",\"long\":");
  j += cfg.longBreak;
  j += F(",\"every\":");
  j += cfg.longEvery;
  j += F(",\"bri\":");
  j += cfg.brightness;
  j += F(",\"auto\":");
  j += cfg.autoStart;
  j += F(",\"h12\":");
  j += cfg.hour12;
  j += F(",\"tz\":\"");
  jsonEscapeAppend(j, cfg.tz);
  j += F("\",\"lock\":");
  j += cfg.otaPass[0] ? 1 : 0;
  j += F(",\"theme\":");
  j += cfg.theme;
  j += F(",\"mode\":");
  j += cfg.mode;
  j += F(",\"delay\":");
  j += cfg.albumDelay;
  j += F(",\"color\":\"");
  j += color;
  j += F("\",\"non\":");
  j += cfg.nightOn;
  j += F(",\"nstart\":");
  j += cfg.nightStart;
  j += F(",\"nend\":");
  j += cfg.nightEnd;
  j += F(",\"nbri\":");
  j += cfg.nightBri;
  j += F(",\"won\":");
  j += cfg.weatherOn;
  j += F(",\"fahr\":");
  j += cfg.fahr;
  j += F(",\"rain\":");
  j += cfg.rainAlert;
  j += F(",\"beta\":");
  j += cfg.beta;
  j += F(",\"lat\":");
  appendFixed(j, cfg.lat, 4);
  j += F(",\"lon\":");
  appendFixed(j, cfg.lon, 4);
  j += F(",\"city\":\"");
  jsonEscapeAppend(j, cfg.city);
  j += F("\",\"name\":\"");
  jsonEscapeAppend(j, cfg.devName);
  j += F("\",\"bgr\":");
  j += cfg.bgr;
  j += F(",\"inv\":");
  j += cfg.invert;
  j += F(",\"flip\":");
  j += cfg.flip;
  j += F(",\"vcom\":");
  j += cfg.vcom;
  j += F(",\"wdown\":");  // Wi-Fi downgrades blocked since power-on
  j += wifiDowngrades;
  j += F(",\"tok\":");  // time confirmed by a second source (1) and time jumps undone since power-on
  j += timeGuard.confirmed ? 1 : 0;
  j += F(",\"tund\":");
  j += timeGuard.undone;
  j += F(",\"pkg\":\"");
  j += cfg.theme == THEME_PACK ? cfg.facePkg : "";
  j += F("\",\"goal\":");
  j += cfg.dailyGoal;
  j += F(",\"act\":");
  j += cfg.activity;
  j += F(",\"lang\":");
  j += cfg.lang;
  j += F(",\"nsun\":");
  j += cfg.nightSun;
  j += F(",\"alexa\":");
  j += cfg.alexa;
  j += F(",\"rotmin\":");
  j += cfg.rotMin;
  j += F(",\"rot\":\"");
  j += rotList;
  j += F("\"},\"alexa\":{\"ago\":");  // seconds since an Echo's last request (-1 = none)
  j += alexaSeen ? (long)((millis() - alexaSeen) / 1000) : -1L;
  j += F(",\"ip\":\"");
  j += alexaSeen ? alexaIp.toString() : String();
  j += F("\",\"last\":");
  j += alexaLast;
  j += F(",\"min\":");
  j += alexaMin;
  j += F("},\"pv\":");
  j += previewActive() ? (previewUntil - millis()) / 1000 + 1 : 0;
  j += F(",\"name\":\"");
  j += lanName[0] ? lanName : netName;
  j += F("\",\"heap\":");
  j += ESP.getFreeHeap();
  j += F(",\"blk\":");
  j += ESP.getMaxFreeBlockSize();
  j += F(",\"pdraw\":");  // ms the screen took to draw the Pomodoro (0 = not measured yet)
  j += pomoDrawMs;
  j += F(",\"pseq\":");  // current phase and the last one the screen has already shown with the numbers (equal = on screen)
  j += phaseSeq;
  j += F(",\"pshown\":");
  j += shownSeq;
  diagJson(j);
  crashJson(j);
  j += F(",\"ver\":\"" FW_VERSION "\"}");
  server.sendHeader("Cache-Control", "no-store");  // city, network and settings: the browser doesn't store them
  server.send(200, "application/json", j);
}

// "-23.5478" -> -23.5478. Reads only what the panel sends (latitude/longitude), without newlib's decimal parsing.
float parseDec(const String &s) {
  const char *p = s.c_str();
  bool neg = *p == '-';
  if (*p == '-' || *p == '+') p++;
  float v = 0, k = 1;
  for (; *p >= '0' && *p <= '9'; p++) v = v * 10 + (*p - '0');
  if (*p == '.')
    for (p++; *p >= '0' && *p <= '9'; p++) v += (*p - '0') * (k /= 10);
  return neg ? -v : v;
}

uint8_t argRange(const char *name, uint8_t cur, int lo, int hi) {
  if (!server.hasArg(name) || server.arg(name).length() == 0) return cur;
  return constrain(server.arg(name).toInt(), lo, hi);
}

// Valid media path: only inside /image or /gif, without "..".
bool mediaPath(const String &p) {
  return (p.startsWith("/image/") || p.startsWith("/gif/")) && p.indexOf("..") < 0;
}

File uploadFile;
String uploadPath, uploadError;
UploadGate photoGate;

void handleUpload() {
  HTTPUpload &up = server.upload();
  if (up.status == UPLOAD_FILE_START) {
    if (uploadFile) uploadFile.close();
    photoGate.begin(false, 0);
    uploadError = "";
    uploadPath = "";
    if (!panelOk() || !uploadAuthed()) {
      uploadError = F("Forbidden");
      return;
    }
    if (!fsOk) {
      uploadError = F("File system unavailable");
      return;
    }
    // safe name: letters, digits, - _ . and at most 28 characters (the LittleFS limit is 31)
    String name;
    for (char c : up.filename)
      if (isalnum(c) || c == '-' || c == '_' || c == '.') name += c;
    while (name.indexOf("..") >= 0) name.replace("..", ".");  // mediaPath rejects "..": the file couldn't be deleted
    if (name.length() > 28) name = name.substring(name.length() - 28);
    if (!isJpg(name) && !isGif(name) && !isWcr(name)) {
      uploadError = F("Use JPG, GIF or WCR");
      return;
    }
    FSInfo fi;
    LittleFS.info(fi);
    if (fi.totalBytes - fi.usedBytes < 16384) {
      uploadError = F("Storage full");
      return;
    }
    if (!LittleFS.exists("/image")) LittleFS.mkdir("/image");
    uploadPath = "/image/" + name;
    uploadFile = LittleFS.open(uploadPath, "w");
    if (!uploadFile) uploadError = F("Could not create the file");
    else photoGate.begin(true, 3 * 1024 * 1024);
  } else if (up.status == UPLOAD_FILE_WRITE) {
    if (!photoGate.active) return;
    if (!photoGate.take(up.currentSize)) uploadError = F("File too large");
    else if (uploadFile.write(up.buf, up.currentSize) != up.currentSize) uploadError = F("Storage full");
    if (uploadError.length()) {
      photoGate.stop();
      uploadFile.close();
      LittleFS.remove(uploadPath);
    }
  } else if (up.status == UPLOAD_FILE_END || up.status == UPLOAD_FILE_ABORTED) {
    photoGate.stop();
    if (uploadFile) uploadFile.close();
    if (up.status == UPLOAD_FILE_ABORTED && uploadPath.length()) LittleFS.remove(uploadPath);
    bool held = packHeld.length();  // validation also decodes: free the pack during it
    if (up.status == UPLOAD_FILE_END && !uploadError.length()) packHold();
    if (up.status == UPLOAD_FILE_END && !uploadError.length() && isGif(uploadPath) && !validGif(uploadPath)) {
      LittleFS.remove(uploadPath);
      uploadError = tr("GIF fora do padrao", "Unsupported GIF", "GIF fuera de norma");
    } else if (up.status == UPLOAD_FILE_END && !uploadError.length() && isWcr(uploadPath) && !validWcr(uploadPath)) {
      LittleFS.remove(uploadPath);
      uploadError = F("Invalid WCR file");
    } else if (up.status == UPLOAD_FILE_END && !uploadError.length() && isJpg(uploadPath) && !validJpg(uploadPath)) {
      LittleFS.remove(uploadPath);
      uploadError = tr("JPG fora do padrao", "Unsupported JPG", "JPG fuera de norma");
    }
    if (!held && !inAlbum) packResume();
    rebuildAlbum();
  }
}

void sendFiles() {
  if (!readOk()) return;
  size_t cap = 16;
  for (const String &n : album) cap += n.length() * 2 + 32;
  String j;
  j.reserve(cap);  // one allocation, instead of growing the reply with each file
  j = F("{\"files\":[");
  bool first = true;
  for (const String &n : album) {
    File f = LittleFS.open(n, "r");
    if (!first) j += ',';
    first = false;
    j += F("{\"n\":\"");
    jsonEscapeAppend(j, n.c_str());
    j += F("\",\"s\":");
    j += (uint32_t)(f ? f.size() : 0);
    j += '}';
    if (f) f.close();
  }
  j += "]}";
  server.send(200, "application/json", j);
}

// ---------- storage: everything that takes up file storage ----------
// The album only shows photos and GIFs, but storage holds more: downloaded faces, the panel, the history
// and, on clocks that came from the original firmware, its files. /api/storage lists everything, in parts
// (without building the whole list in RAM); /api/fsdelete deletes a file or a whole folder, except what
// the clock needs to work (fsKeep).
bool fsKeep(const String &p) {
  if (p == "/stats.bin" || p == "/hooks.txt" || p == "/rotation.txt" || p == "/www" || p.startsWith("/www/")) return true;
  if (p == "/image" || p == "/gif" || p == "/faces") return true;  // the folders stay; what's inside can go
  return cfg.theme == THEME_PACK && p.startsWith(String("/faces/") + cfg.facePkg + ".");  // face in use
}

void sendStorage() {
  if (!readOk()) return;
  static FSInfo fi;
  if (fsOk) LittleFS.info(fi);
  server.sendHeader("Cache-Control", "no-store");
  server.setContentLength(CONTENT_LENGTH_UNKNOWN);
  server.send(200, "application/json", "");
  server.sendContent("{\"used\":" + String(fsOk ? fi.usedBytes : 0) + ",\"total\":" + String(fsOk ? fi.totalBytes : 0) +
                     ",\"block\":" + String(fsOk ? fi.blockSize : 0) + ",\"files\":[");
  std::vector<String> dirs = {"/"};
  bool first = true;
  int n = 0;
  for (size_t k = 0; fsOk && k < dirs.size() && n < 1000; k++) {  // folder by folder (breadth first)
    Dir d = LittleFS.openDir(dirs[k]);
    String base = dirs[k] == "/" ? "" : dirs[k];
    String chunk;
    while (d.next() && n < 1000) {
      String p = base + "/" + d.fileName();
      bool dir = d.isDirectory();
      if (dir && dirs.size() < 64) dirs.push_back(p);
      chunk += first ? F("{\"p\":\"") : F(",{\"p\":\"");
      first = false;
      jsonEscapeAppend(chunk, p.c_str());
      chunk += F("\",\"s\":");
      chunk += dir ? 0 : d.fileSize();
      if (dir) chunk += F(",\"d\":1");
      if (fsKeep(p)) chunk += F(",\"k\":1");
      chunk += '}';
      n++;
      if (chunk.length() > 700) {
        server.sendContent(chunk);
        chunk = "";
      }
      yield();
    }
    if (chunk.length()) server.sendContent(chunk);
  }
  server.sendContent("]}");
  server.sendContent("");  // end of the chunked reply
}

// deletes folder p and everything inside (at most 8 levels); the names are read before deleting
bool fsRemoveAll(const String &p, int depth) {
  if (depth > 8) return false;
  std::vector<String> files, dirs;
  Dir d = LittleFS.openDir(p);
  while (d.next()) (d.isDirectory() ? dirs : files).push_back(p + "/" + d.fileName());
  bool ok = true;
  for (const String &f : files) ok = LittleFS.remove(f) && ok;
  for (const String &s : dirs) ok = fsRemoveAll(s, depth + 1) && ok;
  if (LittleFS.exists(p)) ok = LittleFS.rmdir(p) && ok;  // the core's LittleFS may already have removed the empty folder
  return ok;
}

// ---------- panel protection ----------
// Any site open in the browser can send requests to the clock's IP (CSRF: wipe the Wi-Fi,
// format, write a firmware) or, by pointing a name of its own at that IP, even read the replies (DNS
// rebinding). So:
//  - every action requires the X-SmallTV header, which only the panel sends: an outside site can't (the
//    browser would ask for a CORS permission the clock never gives);
//  - the request must arrive via the clock's IP (Host header with digits only), not via a name.
// Left out are the Alexa API (the Echo doesn't send the header; it only starts and stops the Pomodoro), the
// Wi-Fi portal and recovery mode (they require being near the clock).
bool hostOk() {
  const String &h = server.hostHeader();
  // A real IPv4 (4 parts up to 255, optional port) or this clock's exact .local name
  return safeIpv4Host(h.c_str(), h.length()) || safeOwnHost(h.c_str(), h.length(), netName) ||
         (lanName[0] && safeOwnHost(h.c_str(), h.length(), lanName));
}
bool panelOk() { return hostOk() && server.header("X-SmallTV") == "1"; }
bool deny() {
  server.send_P(403, PSTR("text/plain"), PSTR("Forbidden"));
  return false;
}
// Panel password (the same as /update, user admin): once set, the whole panel and API ask for
// HTTP login (the browser asks once and remembers). Failures get a progressive delay per IP without blocking
// the clock's loop. The Alexa API and recovery mode don't ask for a password.
// Basic login is checked here: the server's authenticate() pulls in Digest mode and MD5 too (~2.5 KB).
bool passOk() {
  return !cfg.otaPass[0] || server.header("Authorization") == "Basic " + base64::encode(String("admin:") + cfg.otaPass, false);
}
void askLogin() {
  server.sendHeader(F("WWW-Authenticate"), F("Basic realm=\"Weather Clock\""));
  server.send(401, "text/plain", "");
}
AuthThrottle authThrottle;
uint32_t requestIp() {
  IPAddress ip = server.client().remoteIP();
  return ((uint32_t)ip[0] << 24) | ((uint32_t)ip[1] << 16) | ((uint32_t)ip[2] << 8) | ip[3];
}
bool authBlocked(uint32_t ip, bool reply) {
  uint32_t wait = 0;
  if (!cfg.otaPass[0] || !authThrottle.blocked(ip, millis(), &wait)) return false;
  if (reply) {
    server.sendHeader("Retry-After", String((wait + 999) / 1000));
    server.send_P(429, PSTR("text/plain"), PSTR("Try again in a few seconds"));
  }
  return true;
}
bool authCheck(bool reply) {
  uint32_t ip = requestIp();
  if (authBlocked(ip, reply)) return false;
  if (passOk()) { authThrottle.success(ip); return true; }
  if (server.hasHeader("Authorization")) authThrottle.fail(ip, millis());
  if (reply) askLogin();
  return false;
}
bool authed() { return authCheck(true); }
bool uploadAuthed() { return authCheck(false); }
bool guard() { return (panelOk() || deny()) && authed(); }   // actions (POST)
bool readOk() { return (hostOk() || deny()) && authed(); }   // reads

// ---------- panel in file storage ----------
// The panel (~19 KB compressed) takes no program flash: it lives in /www/<hash>.gz, where <hash> is the
// first 24 hex digits of the file's SHA-256, computed here on receipt. The firmware only serves the file with
// this version's PANEL_HASH (web.h); without it, it sends the loader, which downloads the panel from the site (with SRI) and
// uploads it to /api/panel. Any other file sent there just gets another name and is never served; accepting
// other hashes lets the panel install the next version's panel before the new firmware is written.
File panelUpload;
UploadGate panelGate;
br_sha256_context panelSha;
String panelResult;

bool fsWriterBusy() {
  return uploadFile || packUpload || panelUpload;
}

void statsFlush() {
  if (!statsWritePending || fsWriterBusy()) return;
  uint16_t day = statsPendingDay;
  uint8_t count = statsPendingCount;
  statsWritePending = false;
  statsWrite(day, count);
  if (!statsWritePending) statsCompute();
}

void handlePanelUpload() {
  HTTPUpload &up = server.upload();
  if (up.status == UPLOAD_FILE_START) {
    if (panelUpload) panelUpload.close();
    panelGate.begin(false, 0);
    panelResult = "";
    if (!panelOk() || !uploadAuthed() || !fsOk) return;
    if (!LittleFS.exists("/www")) LittleFS.mkdir("/www");
    panelUpload = LittleFS.open("/www/_novo", "w");
    if (!panelUpload) return;
    br_sha256_init(&panelSha);
    panelGate.begin(true, 65536);
  } else if (up.status == UPLOAD_FILE_WRITE) {
    if (!panelGate.active) return;
    if (!panelGate.take(up.currentSize) || panelUpload.write(up.buf, up.currentSize) != up.currentSize) {
      panelGate.stop();
      panelUpload.close();
      LittleFS.remove("/www/_novo");
      return;
    }
    br_sha256_update(&panelSha, up.buf, up.currentSize);
  } else if (up.status == UPLOAD_FILE_END || up.status == UPLOAD_FILE_ABORTED) {
    bool ok = panelGate.active && up.status == UPLOAD_FILE_END && panelGate.bytes > 18;
    panelGate.stop();
    if (panelUpload) panelUpload.close();
    if (!ok) {
      LittleFS.remove("/www/_novo");
      return;
    }
    uint8_t d[32];
    br_sha256_out(&panelSha, d);
    char hex[25];
    for (int i = 0; i < 12; i++) snprintf(hex + i * 2, 3, "%02x", d[i]);
    String name = String("/www/") + hex + ".gz";
    LittleFS.remove(name);
    LittleFS.rename("/www/_novo", name);
    // keeps only this version's and the newly arrived one (the next one's, during an update)
    Dir dir = LittleFS.openDir("/www");
    std::vector<String> old;
    while (dir.next())
      if (dir.fileName() != String(hex) + ".gz" && dir.fileName() != PANEL_HASH ".gz") old.push_back(dir.fileName());
    for (const String &n : old) LittleFS.remove("/www/" + n);
    panelResult = hex;
  }
}

void factoryWipe();
void setupWeb() {
  server.collectHeaders("X-SmallTV", "Content-Length", "Authorization", "Origin", "X-Firmware-Sig");
  // panel: this version's from file storage or, without it, the loader that installs it
  server.on("/", HTTP_GET, [] {
    if (!readOk()) return;  // with a password, the browser asks for the login as soon as the panel opens
    server.sendHeader("Cache-Control", "no-cache");  // after a firmware update, the browser fetches the new panel
    File f = fsOk ? LittleFS.open("/www/" PANEL_HASH ".gz", "r") : File();
    if (f) {
      server.streamFile(f, "text/html");  // .gz: the server sends "Content-Encoding: gzip"
      f.close();
      return;
    }
    server.sendHeader("Content-Encoding", "gzip");
    server.send_P(200, "text/html", (PGM_P)LOADER_HTML_GZ, sizeof(LOADER_HTML_GZ));
  });
  server.on("/api/panel", HTTP_POST, [] {
    if (!guard()) return;
    if (!panelResult.length()) server.send_P(400, PSTR("text/plain"), PSTR("Invalid panel"));
    else server.send(200, "text/plain", panelResult == PANEL_HASH ? "ok" : "guardado " + panelResult);
  }, handlePanelUpload);
  server.on("/api/state", HTTP_GET, sendState);
  server.on("/api/stats", HTTP_GET, sendStats);
  server.on("/api/crash", HTTP_POST, [] {  // the panel's "Clear"
    if (!guard()) return;
    crashRec.magic = 0;
    EEPROM.put(CRASH_OFF, crashRec);
    EEPROM.commit();
    server.send(200, "text/plain", "ok");
  });
  // end-of-phase notices: GET reads, POST (w, b) saves, POST test=w|b calls the address and returns the code
  server.on("/api/hooks", HTTP_GET, [] {
    if (!guard()) return;  // the links carry the service account's code
    server.sendHeader("Cache-Control", "no-store");
    String j;
    j.reserve((hookWork.length() + hookBreak.length()) * 2 + 20);
    j = F("{\"w\":\"");
    jsonEscapeAppend(j, hookWork.c_str());
    j += F("\",\"b\":\"");
    jsonEscapeAppend(j, hookBreak.c_str());
    j += F("\"}");
    server.send(200, "application/json", j);
  });
  server.on("/api/hooks", HTTP_POST, [] {
    if (!guard()) return;
    if (server.hasArg("test")) {
      int code = hookFire(server.arg("test") == "b" ? hookBreak : hookWork);
      server.send(200, "text/plain", String(code));
      return;
    }
    String work = hookClean(server.arg("w")), pause = hookClean(server.arg("b"));
    String rawWork = server.arg("w"), rawPause = server.arg("b");
    rawWork.trim(); rawPause.trim();
    if ((rawWork.length() && !work.length()) || (rawPause.length() && !pause.length())) {
      server.send_P(400, PSTR("text/plain"), PSTR("Use a valid http:// address (no spaces or control characters)"));
      return;
    }
    hookWork = work;
    hookBreak = pause;
    File f = fsOk ? LittleFS.open("/hooks.txt", "w") : File();
    if (f) {
      f.print(hookWork + "\n" + hookBreak + "\n");
      f.close();
    }
    server.send(f ? 200 : 500, "text/plain", f ? "ok" : "falhou");
  });
  // weatherbox: radar chosen in the panel (BoM radar id, 0 = the nearest; range in km). The clock only
  // stores the choice: a program on a computer (radar/refresh.sh) downloads the radar and sends the picture
  server.on("/api/radar", HTTP_GET, [] {
    if (!readOk()) return;
    int id = 0, km = 64;
    File f = fsOk ? LittleFS.open("/radar.txt", "r") : File();
    if (f) {
      id = f.parseInt();
      km = f.parseInt();
      f.close();
    }
    char j[48];
    snprintf(j, sizeof j, "{\"id\":%d,\"km\":%d}", id, km);
    server.send(200, "application/json", j);
  });
  server.on("/api/radar", HTTP_POST, [] {
    if (!guard()) return;
    const int id = server.arg("id").toInt(), km = server.arg("km").toInt();
    if (id < 0 || id > 99 || (km != 64 && km != 128 && km != 256 && km != 512)) {
      server.send_P(400, PSTR("text/plain"), PSTR("invalid radar"));
      return;
    }
    File f = fsOk ? LittleFS.open("/radar.txt", "w") : File();
    if (f) {
      f.printf("%d %d\n", id, km);
      f.close();
    }
    server.send(f ? 200 : 500, "text/plain", f ? "ok" : "falhou");
  });
  // restores the history from a backup: "days" = counts from the oldest to day "day"
  server.on("/api/statsimport", HTTP_POST, [] {
    if (!guard()) return;
    if (!fsOk || !server.hasArg("days") || !server.hasArg("day")) {
      server.send_P(400, PSTR("text/plain"), PSTR("Invalid backup"));
      return;
    }
    const String &d = server.arg("days");
    uint16_t day = server.arg("day").toInt();
    std::vector<uint8_t> v;
    v.reserve(min((size_t)STATS_DAYS, d.length() / 2 + 1));
    for (int i = 0; i < (int)d.length();) {
      int e = d.indexOf(',', i);
      if (e < 0) e = d.length();
      int n = d.substring(i, e).toInt();
      if (v.size() >= STATS_DAYS) { server.send_P(400, PSTR("text/plain"), PSTR("Invalid backup")); return; }
      v.push_back(n < 0 ? 0 : n > 255 ? 255 : n);
      i = e + 1;
    }
    if (v.empty() || v.size() > STATS_DAYS) {
      server.send_P(400, PSTR("text/plain"), PSTR("Invalid backup"));
      return;
    }
    stats = {STATS_MAGIC, day, (uint16_t)server.arg("best").toInt(), (uint32_t)server.arg("total").toInt()};
    File fh = LittleFS.open("/stats.bin", "w");
    if (fh) {
      uint8_t ring[STATS_DAYS] = {0};
      for (size_t i = 0; i < v.size(); i++) ring[(day - (v.size() - 1) + i) % STATS_DAYS] = v[i];
      fh.write((const uint8_t *)&stats, sizeof stats);
      fh.write(ring, STATS_DAYS);
      fh.close();
    }
    statsCompute();
    server.send(fh ? 200 : 500, "text/plain", fh ? "ok" : "falhou");
  });
  // list of faces for the panel gallery (comes from faces_list.h)
  server.on("/api/faces", HTTP_GET, [] {
    if (!readOk()) return;
    String j;
    j.reserve(1800);
    j = '[';
    for (uint8_t t = 0; t < THEME_COUNT; t++) {
      if (t) j += ',';
      j += F("{\"n\":\"");
      char nb[40], db[72];  // name and description are in flash
      strncpy_P(nb, uiFaceName(t), sizeof nb - 1), nb[sizeof nb - 1] = 0;
      strncpy_P(db, uiFaceDesc(t), sizeof db - 1), db[sizeof db - 1] = 0;
      jsonEscapeAppend(j, nb);
      j += F("\",\"d\":\"");
      jsonEscapeAppend(j, db);
      j += F("\"}");
    }
    // installed packs: name/description/author come from the <id>.txt written at install
    if (fsOk) {
      Dir d = LittleFS.openDir("/faces");
      while (d.next()) {
        String fn = d.fileName();
        if (!fn.endsWith(".json") || fn.startsWith("_")) continue;
        String id = fn.substring(0, fn.length() - 5), name = id, desc, author;
        File t = LittleFS.open("/faces/" + id + ".txt", "r");
        if (t) {
          name = t.readStringUntil('\n');
          desc = t.readStringUntil('\n');
          author = t.readStringUntil('\n');
          t.close();
        }
        j += F(",{\"n\":\"");
        jsonEscapeAppend(j, name.c_str());
        j += F("\",\"d\":\"");
        jsonEscapeAppend(j, desc.c_str());
        j += F("\",\"a\":\"");
        jsonEscapeAppend(j, author.c_str());
        j += F("\",\"pkg\":\"");
        j += id;
        j += F("\"}");
      }
    }
    j += "]";
    server.send(200, "application/json", j);
  });
  // PNG preview of a face for the panel gallery. The built-in ones live on the site (generated by the
  // simulator, taking no flash on the clock); installed packs' ones, on LittleFS.
  server.on("/face", HTTP_GET, [] {
    if (!readOk()) return;
    if (server.hasArg("pkg")) {  // installed pack preview (/faces/<id>.png, if it came with one)
      const String &id = server.arg("pkg");
      File f = fsOk && idOk(id) ? LittleFS.open("/faces/" + id + ".png", "r") : File();
      if (!f) {
        server.send(404, "text/plain", "");
        return;
      }
      server.sendHeader("Cache-Control", "max-age=300");
      server.streamFile(f, "image/png");
      f.close();
      return;
    }
    int t = server.arg("t").toInt();
    if (t < 0 || t >= THEME_COUNT) {
      server.send(404, "text/plain", "");
      return;
    }
    server.sendHeader("Location", String(F("https://fpv-db.github.io/WeatherClock/img/faces/face-")) + t + ".png");
    server.send(302, "text/plain", "");
  });
  // anti-ghosting: v=0..63 applies it and shows the pattern (3 min); save=1 stores; stop=1 goes back to the saved value
  server.on("/api/vcom", HTTP_POST, [] {
    if (!guard()) return;
    if (server.hasArg("v")) {
      int v = server.arg("v").toInt();
      vcomTest = v < 0 ? 0 : v > 0x3F ? 0x3F : v;
      applyVcom(vcomTest);
      if (!vcomTestUntil) vcomDraw = 2;
      else if (vcomDraw < 1) vcomDraw = 1;
      vcomTestUntil = millis() + 180000;
      if (!vcomTestUntil) vcomTestUntil = 1;
    }
    if (server.arg("save") == "1") {
      cfg.vcom = vcomTest;
      cfg.vcomChk = cfg.vcom ^ 0xDA;
      saveSettings();
    }
    if (server.arg("save") == "1" || server.arg("stop") == "1") vcomTestUntil = millis();  // the loop ends it
    server.send(200, "application/json", String(F("{\"vcom\":")) + cfg.vcom + "}");
  });
  server.on("/api/cmd", HTTP_POST, [] {
    if (!guard()) return;
    if (server.arg("c") == "preview") {
      int t = server.arg("t").toInt();
      bool ok = t >= 0 && t < THEME_COUNT;
      if (server.hasArg("pkg")) {  // pack preview: loads it into the engine until the preview ends
        ok = loadPack(server.arg("pkg"));
        t = THEME_PACK;
      }
      if (ok) {
        previewTheme = t;
        previewUntil = millis() + 15000;
        viewUntil = millis() + 15000;  // the album doesn't interrupt the preview
      }
    }
    command(server.arg("c"));
    sendState();
  });
  server.on("/api/settings", HTTP_POST, [] {
    if (!guard()) return;
    cfg.work = argRange("work", cfg.work, 1, 99);
    cfg.shortBreak = argRange("short", cfg.shortBreak, 1, 99);
    cfg.longBreak = argRange("long", cfg.longBreak, 1, 99);
    cfg.longEvery = argRange("every", cfg.longEvery, 1, 8);
    cfg.brightness = argRange("bri", cfg.brightness, 5, 100);  // minimum 5: with 0 the screen would go dark
    cfg.autoStart = argRange("auto", cfg.autoStart, 0, 1);
    cfg.hour12 = argRange("h12", cfg.hour12, 0, 1);
    if (server.hasArg("theme") && server.arg("theme").length()) {  // built-in: free the pack engine
      cfg.theme = argRange("theme", cfg.theme, 0, THEME_COUNT - 1);
      facePackUnload();
    }
    if (server.hasArg("pkg") && loadPack(server.arg("pkg"))) {
      cfg.theme = THEME_PACK;
      strlcpy(cfg.facePkg, server.arg("pkg").c_str(), sizeof cfg.facePkg);
    }
    uint8_t goal = argRange("goal", cfg.dailyGoal, 1, 30);
    if (goal != cfg.dailyGoal) {  // the streak is counted with the current goal
      cfg.dailyGoal = goal;
      statsCompute();
    }
    cfg.activity = argRange("act", cfg.activity, 0, ACT_COUNT - 1);
    uint8_t lang = argRange("lang", cfg.lang, 0, 2);
    if (lang != cfg.lang) uiSetLang(cfg.lang = lang);
    uint8_t bgr = argRange("bgr", cfg.bgr, 0, 1), inv = argRange("inv", cfg.invert, 0, 1),
            flip = argRange("flip", cfg.flip, 0, 1);
    bool panelChanged = bgr != cfg.bgr || inv != cfg.invert || flip != cfg.flip;
    cfg.bgr = bgr;
    cfg.invert = inv;
    cfg.flip = flip;
    cfg.mode = argRange("mode", cfg.mode, 0, 2);
    cfg.albumDelay = argRange("delay", cfg.albumDelay, 3, 255);
    cfg.nightOn = argRange("non", cfg.nightOn, 0, 1);
    cfg.nightStart = argRange("nstart", cfg.nightStart, 0, 23);
    cfg.nightEnd = argRange("nend", cfg.nightEnd, 0, 23);
    cfg.nightBri = argRange("nbri", cfg.nightBri, 1, 100);
    cfg.nightSun = argRange("nsun", cfg.nightSun, 0, 1);
    cfg.rotMin = argRange("rotmin", cfg.rotMin, 0, 240);
    cfg.alexa = argRange("alexa", cfg.alexa, 0, 1);
    alexaBegin();  // switched on now: starts answering discovery without a restart
    if (server.hasArg("rot")) rotSet(server.arg("rot"));
    uint8_t won = argRange("won", cfg.weatherOn, 0, 1);
    uint8_t fahr = argRange("fahr", cfg.fahr, 0, 1), rain = argRange("rain", cfg.rainAlert, 0, 1);
    cfg.beta = argRange("beta", cfg.beta, 0, 1);
    if (fahr != cfg.fahr || rain != cfg.rainAlert) uiInvalidate();  // numbers and the warning change on screen
    cfg.fahr = fahr;
    cfg.rainAlert = rain;
    const String &color = server.arg("color");
    if (color.length() == 7 && color[0] == '#') {
      long v = strtol(color.c_str() + 1, nullptr, 16);
      cfg.colR = v >> 16;
      cfg.colG = v >> 8;
      cfg.colB = v;
    }
    // quotes or a backslash would break the /api/state JSON and freeze the panel
    if (server.hasArg("name")) {  // weatherbox: the clock's name
      String n = server.arg("name");
      n.trim();
      bool ok = n.length() < sizeof cfg.devName;
      for (char c : n) ok = ok && c >= 0x20 && c < 0x7F && c != '"' && c != '\\';
      if (ok) {
        strlcpy(cfg.devName, n.c_str(), sizeof cfg.devName);
        uiSetOwner(cfg.devName);
      }
    }
    String tz = server.arg("tz");
    tz.trim();
    if (tz.length() > 0 && safeText(tz)) {
      strlcpy(cfg.tz, tz.c_str(), sizeof(cfg.tz));
      applyTimezone();
    }
    bool newPlace = false;
    // outside ±90/±180 is not a place; also prevents an overflow in the state's decimal conversion
    float lat = parseDec(server.arg("lat")), lon = parseDec(server.arg("lon"));
    if (server.hasArg("lat") && server.hasArg("lon") && safeText(server.arg("city")) && fabsf(lat) <= 90 && fabsf(lon) <= 180) {
      cfg.lat = lat;
      cfg.lon = lon;
      strlcpy(cfg.city, server.arg("city").c_str(), sizeof(cfg.city));
      newPlace = true;
    }
    if (newPlace || won != cfg.weatherOn) {
      cfg.weatherOn = won;
      wx.ok = false;
      wx.version++;
      wxNext = aqiNext = millis();  // fetch the weather (and air quality) now
      wx.aqi = wx.pm25 = wx.pm10 = 0xFFFF;
    }
    saveSettings();
    updateBrightness(true);
    if (panelChanged) applyPanel();
    // Brightness, night hours and options that don't show on screen: without clearing and redrawing everything, which would flicker
    // on every movement of the slider (together with the brightness ramp)
    static const char *const QUIET[] = {"bri", "non", "nstart", "nend", "nbri", "nsun", "beta", "alexa", "rotmin"};
    bool quiet = true;
    for (int i = 0; quiet && i < server.args(); i++) {
      bool q = false;
      for (const char *k : QUIET) q |= server.argName(i) == k;
      quiet = q || server.argName(i) == "plain";
    }
    if (!quiet) {
      uiInvalidate();  // redraw with the new colour/theme
      viewUntil = 0;   // re-evaluate clock/album with the new mode
    }
    sendState();
  });
  server.on("/api/files", HTTP_GET, sendFiles);
  // installs a face pack: validates it in the engine, uses the JSON's "id" as the file name
  server.on("/api/faceinstall", HTTP_POST, [] {
    const bool ready = packFaceReady;
    packFaceReady = false;
    if (!guard()) return;
    String msg;
    bool ok = ready && !packUploadError.length() && loadPackFile("/faces/_novo.json", msg);
    String id = ok ? facePackId() : "", name = ok ? facePackName() : "";
    if (ok && id[0] == '_') {  // "_novo" and the like are the upload's temporary files
      ok = false;
      msg = F("invalid id");
    }
    if (ok) {
      LittleFS.remove("/faces/" + id + ".json");
      LittleFS.rename("/faces/_novo.json", "/faces/" + id + ".json");
      LittleFS.remove("/faces/" + id + ".png");
      if (LittleFS.exists("/faces/_novo.png")) LittleFS.rename("/faces/_novo.png", "/faces/" + id + ".png");
      File t = LittleFS.open("/faces/" + id + ".txt", "w");  // metadata for the panel's list
      if (t) {
        t.printf("%s\n%s\n%s\n", facePackName(), facePackDesc(), facePackAuthor());
        t.close();
      }
    } else {
      LittleFS.remove("/faces/_novo.json");
      LittleFS.remove("/faces/_novo.png");
    }
    restoreActivePack();  // the test loaded the new pack into the engine; go back to the one that was active
    if (!ok) {
      server.send(400, "text/plain", packUploadError.length() ? packUploadError : "Invalid face pack: " + msg);
      return;
    }
    String reply;
    reply.reserve(id.length() + name.length() * 2 + 32);
    reply = F("{\"ok\":1,\"id\":\"");
    reply += id;
    reply += F("\",\"name\":\"");
    jsonEscapeAppend(reply, name.c_str());
    reply += F("\"}");
    server.send(200, "application/json", reply);
  }, handlePackUpload);
  server.on("/api/facedelete", HTTP_POST, [] {
    if (!guard()) return;
    const String &id = server.arg("pkg");
    if (!fsOk || !idOk(id) || !LittleFS.remove("/faces/" + id + ".json")) {
      server.send_P(400, PSTR("text/plain"), PSTR("Face pack not found"));
      return;
    }
    LittleFS.remove("/faces/" + id + ".png");
    LittleFS.remove("/faces/" + id + ".txt");
    if (cfg.theme == THEME_PACK && id == cfg.facePkg) {  // it was the active one: back to the first built-in
      cfg.theme = THEME_MATRIX;
      cfg.facePkg[0] = 0;
      saveSettings();
      facePackUnload();
      uiInvalidate();
    }
    server.send(200, "text/plain", "ok");
  });
  server.on("/api/upload", HTTP_POST, [] {
    if (!guard()) return;
    if (uploadError.length()) server.send(400, "text/plain", uploadError);
    else server.send(200, "text/plain", "ok");
  }, handleUpload);
  server.on("/api/delete", HTTP_POST, [] {
    if (!guard()) return;
    const String &f = server.arg("f");
    if (curFile == f) {
      stopAlbum();
      viewUntil = 0;
    }
    if (!fsOk || !mediaPath(f) || !LittleFS.remove(f)) {
      server.send_P(400, PSTR("text/plain"), PSTR("Could not delete"));
      return;
    }
    rebuildAlbum();
    server.send(200, "text/plain", "ok");
  });
  server.on("/api/storage", HTTP_GET, sendStorage);
  // deletes any file or folder in storage, except what the clock needs (fsKeep)
  server.on("/api/fsdelete", HTTP_POST, [] {
    if (!guard()) return;
    String f = server.arg("f");
    if (!fsOk || !f.startsWith("/") || f.length() < 2 || f.length() > 96 || f.indexOf("..") >= 0 || f.indexOf("//") >= 0 ||
        f.endsWith("/") || fsKeep(f) || !LittleFS.exists(f)) {
      server.send_P(400, PSTR("text/plain"), PSTR("Could not delete"));
      return;
    }
    if (curFile == f || curFile.startsWith(f + "/")) {  // the file on screen, or its folder
      stopAlbum();
      viewUntil = 0;
    }
    File h = LittleFS.open(f, "r");
    bool dir = h && h.isDirectory();
    if (h) h.close();
    bool ok = dir ? fsRemoveAll(f, 0) : LittleFS.remove(f);
    fsInfoAt = 0;  // storage use changed
    rebuildAlbum();
    server.send(ok ? 200 : 500, "text/plain", ok ? "ok" : "Nao foi possivel apagar");
  });
  server.on("/api/show", HTTP_POST, [] {
    if (!guard()) return;
    const String &f = server.arg("f");
    if (phase != IDLE) {
      server.send_P(409, PSTR("text/plain"), PSTR("Pomodoro in progress"));
      return;
    }
    if (!fsOk || !mediaPath(f) || !showAlbumItem(f)) {
      server.send_P(400, PSTR("text/plain"), PSTR("Invalid file"));
      return;
    }
    viewUntil = millis() + cfg.albumDelay * 1000UL;
    server.send(200, "text/plain", "ok");
  });
  server.on("/api/migdone", HTTP_POST, [] {  // the panel restored (or skipped) the migration backup
    if (!guard()) return;
    if (fsMark.magic == FS_MAGIC && fsMark.pend) {
      fsMark.pend = 0;
      EEPROM.put(FS_OFF, fsMark);
      EEPROM.commit();
    }
    server.send(200, "text/plain", "ok");
  });
  // weatherbox: "Prepare as a gift" in the panel: the same full erase as recovery mode
  server.on("/api/giftreset", HTTP_POST, [] {
    if (!guard()) return;
    server.send(200, "text/plain", "ok");
    factoryWipe();
  });
  server.on("/api/format", HTTP_POST, [] {
    if (!guard()) return;
    stopAlbum();
    LittleFS.end();
    fsOk = LittleFS.format() && LittleFS.begin();
    if (fsOk) LittleFS.mkdir("/image");
    rebuildAlbum();
    server.send(fsOk ? 200 : 500, "text/plain", fsOk ? "ok" : "falhou");
  });
  // Media files for the panel thumbnails
  server.on("/fs", HTTP_GET, [] {
    if (!readOk()) return;
    const String &f = server.arg("f");
    File file;
    if (fsOk && mediaPath(f)) file = LittleFS.open(f, "r");
    if (!file) {
      server.send_P(404, PSTR("text/plain"), PSTR("not found"));
      return;
    }
    server.sendHeader("Cache-Control", "max-age=86400");
    server.streamFile(file, isGif(f) ? "image/gif" : "image/jpeg");
    file.close();
  });
  // Changes the /update password. If there is already a password, the current one is required.
  server.on("/api/otapass", HTTP_POST, [] {
    if (!guard()) return;
    if (cfg.otaPass[0] && server.arg("old") != cfg.otaPass) {
      server.send_P(403, PSTR("text/plain"), PSTR("Current password is wrong"));
      return;
    }
    const String &p = server.arg("new");
    if (p.length() >= sizeof(cfg.otaPass)) {
      server.send_P(400, PSTR("text/plain"), PSTR("Password too long (max 23)"));
      return;
    }
    strlcpy(cfg.otaPass, p.c_str(), sizeof(cfg.otaPass));
    saveSettings();
    server.send(200, "text/plain", p.length() ? "Password set (user: admin)" : "Password removed");
  });
  server.on("/api/wifireset", HTTP_POST, [] {
    if (!guard()) return;
    server.send(200, "text/plain", "ok");
    delay(300);
    WiFi.persistent(true);
    WiFi.disconnect(true);  // with persistent, erases the saved network
    safeRestart();
  });
  setupUpdate();
  server.on("/description.xml", HTTP_GET, sendHueDescription);  // Alexa (Hue bridge)
  server.onNotFound(alexaApi);                                   // /api/<user>/lights...
  server.begin();
}

// ---------- firmware update (/update) ----------
// Accepts our firmware and the original GeekMagic one (to go back to factory), but checks the file
// before swapping: an ESP8266 image (0xE9 at the start and in the app), the size and the CRC32 that elf2bin
// writes in the header (offsets 4112 and 4116; every original V9.0.x version has them too) and whether it fits in the
// free space. A truncated, corrupt or other-device file is refused and the current firmware stays.
// User "admin"; an empty password (or recovery mode) skips authentication.
struct OtaCheck { uint32_t got, size, want, crc; uint8_t field[8]; String err; bool authOk, begun, gz, finished; } ota;

void otaConsume(const uint8_t *p, size_t n) {
  for (size_t i = 0; i < n && !ota.err.length(); i++, ota.got++) {
    uint32_t o = ota.got;
    uint8_t v = p[i];
    if ((o == 0 || o == 4096) && v != 0xE9) ota.err = F("not an ESP8266 firmware");
    if (o >= 4112 && o < 4120) {
      ota.field[o - 4112] = v;
      v = 0;  // the size and CRC fields go into the sum as zeros
      if (o == 4119) {
        memcpy(&ota.size, ota.field, 4);
        memcpy(&ota.want, ota.field + 4, 4);
        uint32_t room = (ESP.getFreeSketchSpace() - 0x1000) & 0xFFFFF000;
        if (ota.size < 4120 || (!ota.gz && ota.size > room)) ota.err = F("invalid size or not enough space");  // .gz: checked in otaVerifyGz
      }
    }
    if (ota.size && o >= ota.size) ota.err = F("file larger than stated");
    ota.crc ^= (uint32_t)v << 24;
    for (int k = 0; k < 8; k++) ota.crc = (ota.crc << 1) ^ (ota.crc & 0x80000000 ? 0x04C11DB7 : 0);
  }
}

// ---------- compressed update (.bin.gz) ----------
// The .gz is ~74% of the firmware, so more firmware fits in the 1 MB area: the new version no longer needs
// to fit whole beside the current one. The .gz is written at the END of the area and the boot loader (eboot)
// decompresses it on restart, over the current firmware, sector by sector. A corrupt .gz would leave the
// clock with no firmware; so, before allowing the swap, the clock reads back the written .gz, decompresses
// all of it and checks: the .gz CRC, header, size and CRC of the image (otaConsume) and that the decompressed
// image doesn't reach the .gz the eboot still has to read. If anything fails, the swap is cancelled.
// 8 KB window (build.sh compresses this way): a .gz with a bigger window is refused by uzlib.
static uint32_t gzAddr, gzEnd;
static uint8_t *gzBuf;
static int gzRead(struct uzlib_uncomp *m) {
  if (gzAddr >= gzEnd) return -1;
  uint32_t n = gzEnd - gzAddr < 512 ? gzEnd - gzAddr : 512;
  if (!ESP.flashRead(gzAddr, gzBuf, n)) return -1;
  gzAddr += n;
  m->source = gzBuf + 1;
  m->source_limit = gzBuf + n;
  return gzBuf[0];
}

// weatherbox: the 8 KB dictionary for the .gz check is reserved at the start of the upload (see otaSigBegin)
static uint8_t *otaDict = nullptr;
bool otaVerifyGz() {
  eboot_command cmd;
  if (eboot_command_read(&cmd) || cmd.action != ACTION_COPY_RAW) {
    ota.err = F("update not scheduled");
    return false;
  }
  uint32_t src = cmd.args[0];
  uint8_t *dict = otaDict ? otaDict : (uint8_t *)malloc(8192), out[256];
  otaDict = nullptr;  // now it belongs to the checker: freed at the end, together with the rest
  TINF_DATA *d = (TINF_DATA *)calloc(1, sizeof(TINF_DATA));  // ~1.2 KB of tables: off the stack
  gzBuf = (uint8_t *)malloc(512);
  if (dict && gzBuf && d) {
    gzAddr = src;
    gzEnd = src + cmd.args[2];
    uzlib_init();
    d->source_read_cb = gzRead;
    uzlib_uncompress_init(d, dict, 8192);
    int res = uzlib_gzip_parse_header(d);
    ota.got = ota.size = ota.want = 0;  // otaConsume confere agora a imagem descompactada
    ota.crc = 0xFFFFFFFF;
    while (res == TINF_OK && !ota.err.length()) {
      d->dest_start = d->dest = out;
      d->dest_limit = out + sizeof out;
      res = uzlib_uncompress_chksum(d);
      if (res == TINF_OK || res == TINF_DONE) otaConsume(out, d->dest - out);
      yield();
    }
    if (ota.err.length()) {}
    else if (res != TINF_DONE) ota.err = F("compressed file is corrupt");
    else if (ota.got < 4120 || ota.got != ota.size) ota.err = F("incomplete image");
    else if (ota.crc != ota.want) ota.err = F("image is corrupt (CRC)");
    else if (ota.size > src) ota.err = F("firmware too large to decompress");
    else {
      // The eboot doesn't read the gzip's size: it uses the LAST 4 bytes of the written area as the image
      // size. Anything after the gzip (like 1.20.0's 260 signature bytes) becomes the
      // size, and the eboot writes only the start over sector 0 and erases its own boot
      // loader: the clock no longer boots. The swap is only allowed if that number is the checked image's.
      uint8_t t[4];
      if (cmd.args[2] < 4 || !ESP.flashRead(src + cmd.args[2] - 4, t, 4)) ota.err = F("cannot read the end of the file");
      else if ((uint32_t)(t[0] | t[1] << 8 | t[2] << 16 | (uint32_t)t[3] << 24) != ota.got)
        ota.err = F("data after the gzip (send the .bin.gz without a signature, or the .bin)");
    }
  } else ota.err = F("not enough memory to check the file");
  free(dict);
  free(gzBuf);
  free(d);
  if (ota.err.length()) eboot_command_clear();  // cancela a troca: o firmware atual continua
  return !ota.err.length();
}

// ---------- update signatures ----------
// Over the network, the clock only swaps firmware if the file comes with the project's signature: RSA-2048 over the
// SHA-256 of the file exactly as uploaded (.bin or .bin.gz), in base64 in the X-Firmware-Sig header.
// The signature does NOT go inside the file: in 1.20.0 it went at the end of the .bin.gz and the eboot used the last 4
// bytes as the image size, erasing the boot loader. Nor does it use the core Updater's signature
// (which expects the same suffix). The check is done before Update.end(true): without a valid signature
// nothing is scheduled and the current firmware carries on. Recovery mode (physical: its own network with the password on
// the screen) accepts unsigned firmware, to go back to the original or if the key is lost.
// Only BearSSL's RSA maths (i15, the smallest), with the key as bytes: the core's classes (PublicKey,
// SigningVerifier) pull in the PEM reader and the elliptic curves, ~30 KB more in the firmware.
// The maths runs on the core's extra stack (6.2 KB, allocated only during the check).
extern "C" uint32_t thunk_br_rsa_i15_pkcs1_vrfy(const unsigned char *x, size_t xlen, const unsigned char *oid,
                                                size_t hlen, const br_rsa_public_key *pk, unsigned char *out);
make_stack_thunk(br_rsa_i15_pkcs1_vrfy);
static br_sha256_context otaHash;
// The signature (256 bytes) only exists during the upload: allocated here and freed at the end (or on abort), instead of
// taking up fixed RAM all the time.
static uint8_t *otaSig = nullptr;
static bool otaSigGiven;
// weatherbox: BearSSL's extra stack (6.2 KB) is reserved at the start of the upload, while memory is still
// in one piece; at the end, after hours of fragmentation plus the upload buffers, it might not fit
static bool otaThunk = false;
static void otaSigFree() {
  free(otaSig);
  otaSig = nullptr;
  otaSigGiven = false;
  if (otaThunk) {
    stack_thunk_del_ref();
    otaThunk = false;
  }
  free(otaDict);  // upload interrupted before the check
  otaDict = nullptr;
}

static void otaSigBegin() {
  br_sha256_init(&otaHash);
  otaSigFree();
  const String &b64 = server.header("X-Firmware-Sig");
  if (b64.length() < 340 || b64.length() > 348) return;  // 256 bytes = 344 characters
  char buf[264];
  base64_decodestate st;
  base64_init_decodestate(&st);
  if (base64_decode_block(b64.c_str(), b64.length(), buf, &st) != 256) return;
  otaSig = (uint8_t *)malloc(256);
  if (!otaSig) return;
  memcpy(otaSig, buf, 256);
  otaSigGiven = true;
  if (ESP.getMaxFreeBlockSize() >= 7500) {  // add_ref aborts if it doesn't fit: only ask with room to spare
    stack_thunk_add_ref();
    otaThunk = true;
  }
}

static bool otaSigOk() {
  if (recoveryMode) return true;
  if (!otaSigGiven) {
    ota.err = F("unsigned firmware (use the file from the website, or recovery mode)");
    return false;
  }
  if (!otaThunk && ESP.getMaxFreeBlockSize() < 7500) {  // the maths uses an extra 6.2 KB stack
    ota.err = F("not enough memory to check the signature");
    return false;
  }
  uint8_t n[sizeof OTA_KEY_N], e[sizeof OTA_KEY_E], want[32], got[32];
  memcpy_P(n, OTA_KEY_N, sizeof n);  // BearSSL reads the key byte by byte: it has to be in RAM
  memcpy_P(e, OTA_KEY_E, sizeof e);
  br_rsa_public_key key = {n, sizeof n, e, sizeof e};
  br_sha256_out(&otaHash, want);
  stack_thunk_add_ref();
  bool ok = thunk_br_rsa_i15_pkcs1_vrfy(otaSig, 256, BR_HASH_OID_SHA256, sizeof got, &key, got) &&
            !memcmp(got, want, sizeof got);
  stack_thunk_del_ref();
  if (otaThunk) {  // weatherbox: give the reserved stack back now: the .gz check that comes next needs the memory
    stack_thunk_del_ref();
    otaThunk = false;
  }
  if (!ok) ota.err = F("invalid signature");
  return ok;
}

void setupUpdate() {
  auto authOk = [] {
    if (!panelOk()) return false;
    if (recoveryMode) return true;
    return uploadAuthed();
  };
  server.on("/update", HTTP_GET, [] {
    if (!hostOk()) { deny(); return; }
    if (!recoveryMode && !authed()) return;
    String p = F("<!doctype html><meta charset=utf-8><meta name=viewport content='width=device-width,initial-scale=1'><title>Weather Clock</title>"
                 "<style>body{font:16px system-ui;background:#111;color:#eee;max-width:420px;margin:auto;padding:20px}"
                 "input,button{width:100%;padding:12px;margin:8px 0;border-radius:10px;border:1px solid #333;background:#1c1c1c;color:#eee;font:inherit}"
                 "button{background:#ff5a47;border:0;font-weight:700}</style><h2>");
    p += tr("Atualizar firmware", "Update firmware", "Actualizar firmware");
    p += F("</h2><form method=post enctype=multipart/form-data><input type=file name=firmware accept=.bin,.gz required>");
    if (!recoveryMode) {  // outside recovery mode only signed firmware gets in: the .sig comes with it on the site
      p += tr("Assinatura (.sig)", "Signature (.sig)", "Firma (.sig)");
      p += F("<input type=file name=sig accept=.sig required>");
    }
    p += F("<button>");
    p += tr("Enviar", "Upload", "Enviar");
    // Only the firmware goes in the body; the signature travels in base64 in the X-Firmware-Sig header.
    p += F("</button></form><small>v" FW_VERSION "</small>"
           "<script>document.forms[0].onsubmit=async e=>{e.preventDefault();const f=e.target,h={'X-SmallTV':'1'},d=new FormData();"
           "d.append('firmware',f.firmware.files[0]);"
           "if(f.sig&&f.sig.files[0])h['X-Firmware-Sig']=btoa(String.fromCharCode(...new Uint8Array(await f.sig.files[0].arrayBuffer())));"
           "document.body.innerHTML='...';"
           "fetch('/update',{method:'POST',body:d,headers:h}).then(r=>r.text()).then(t=>document.body.innerHTML=t)}</script>");
    server.send(200, "text/html", p);
  });
  server.on("/update", HTTP_POST, [authOk] {
      if (!authOk() || !ota.authOk) return askLogin();
      if (!ota.err.length() && !ota.finished) ota.err = F("incomplete upload");
      if (ota.err.length()) {
        if (!inAlbum) packResume();  // didn't update: the face comes back
        server.send(400, "text/plain", "Update error: " + ota.err);
        return;
      }
      server.send(200, "text/html", F("<meta http-equiv=refresh content='20;URL=/'>Update Success! Rebooting..."));
      delay(200);
      safeRestart();
    }, [authOk] {
      HTTPUpload &up = server.upload();
      if (up.status == UPLOAD_FILE_START) {
        ota = {0, 0, 0, 0xFFFFFFFF, {0}, String(), authOk(), false, false, false};
        packHold();  // weatherbox: frees the face's RAM: the signature check needs ~17 KB contiguous
        otaSigBegin();
        if (!ota.authOk) ota.err = F("password");
        else if (inAlbum) stopAlbum();  // frees RAM and LittleFS during the write
      } else if (up.status == UPLOAD_FILE_WRITE && !ota.err.length()) {
        if (!ota.begun) {  // first chunk: a .gz goes to the end of the area (upload size); a .bin, into the free space
          ota.begun = true;
          ota.gz = up.currentSize > 1 && up.buf[0] == 0x1F && up.buf[1] == 0x8B;
          if (ota.gz && !otaDict && ESP.getMaxFreeBlockSize() >= 8192 + 1024) otaDict = (uint8_t *)malloc(8192);  // weatherbox
          uint32_t size = ota.gz ? server.header("Content-Length").toInt() : (ESP.getFreeSketchSpace() - 0x1000) & 0xFFFFF000;
          if (!size || !Update.begin(size, U_FLASH)) ota.err = size ? Update.getErrorString() : String(F("unknown size"));
        }
        if (!ota.gz) otaConsume(up.buf, up.currentSize);
        br_sha256_update(&otaHash, up.buf, up.currentSize);
        if (!ota.err.length() && Update.write(up.buf, up.currentSize) != up.currentSize) ota.err = Update.getErrorString();
        if (ota.err.length()) Update.end();  // give up: the current firmware carries on
      } else if (up.status == UPLOAD_FILE_END && !ota.err.length()) {
        if (!ota.begun) ota.err = F("empty file");
        else if (ota.gz) {
          if (!otaSigOk()) Update.end();  // signature before scheduling the swap: without it nothing changes
          else if (!Update.end(true)) ota.err = Update.getErrorString();
          else otaVerifyGz();
        } else if (ota.got < 4120 || ota.got != ota.size) ota.err = F("incomplete file");
        else if (ota.crc != ota.want) ota.err = F("file is corrupt (CRC)");
        else otaSigOk();
        if (ota.gz) {}
        else if (ota.err.length()) Update.end();
        else if (!Update.end(true)) ota.err = Update.getErrorString();
        ota.finished = !ota.err.length();
      } else if (up.status == UPLOAD_FILE_ABORTED) {
        Update.end();
        ota.err = F("upload interrupted");
      }
      if (up.status == UPLOAD_FILE_END || up.status == UPLOAD_FILE_ABORTED) otaSigFree();
      yield();
    });
}

// ---------- recovery mode ----------
#define RECOVERY_AP "WeatherClock-Recovery"
void startRecovery() {
  newFormToken();
  WiFi.mode(WIFI_AP);
  WiFi.softAP(RECOVERY_AP, cfg.apPass);
  String pw = String(tr("senha: ", "password: ", "clave: ")) + cfg.apPass;
  message(tr("Modo de recuperacao", "Recovery mode", "Modo de recuperacion"), RECOVERY_AP, pw.c_str(), "http://192.168.4.1");
  server.on("/", HTTP_GET, [] {
    String p = F("<!doctype html><meta charset=utf-8><meta name=viewport content='width=device-width,initial-scale=1'><title>Weather Clock</title>"
                 "<style>body{font:16px system-ui;background:#111;color:#eee;max-width:420px;margin:auto;padding:20px}"
                 "button,a{display:block;width:100%;box-sizing:border-box;text-align:center;padding:12px;margin:8px 0;border-radius:10px;"
                 "border:1px solid #333;background:#1c1c1c;color:#eee;font:inherit;text-decoration:none}.p{background:#ff5a47;border:0;font-weight:700}</style><h2>");
    p += tr("Modo de recuperacao", "Recovery mode", "Modo de recuperacion");
    p += F("</h2><p>v" FW_VERSION " &middot; ");
    p += WiFi.status() == WL_CONNECTED ? WiFi.localIP().toString() : String(F("192.168.4.1"));
    p += F("</p><a class=p href=/update>");
    p += tr("Atualizar firmware", "Update firmware", "Actualizar firmware");
    p += F("</a><a href=/api/stats download=historico.json>");
    p += tr("Baixar historico de focos", "Download focus history", "Descargar historial");
    p += F("</a><form method=post action=/rec/factory>");
    p += formTokenField(); p += F("<button>");
    p += tr("Voltar aos ajustes de fabrica", "Reset settings to defaults", "Restablecer ajustes");
    p += F("</button></form><form method=post action=/rec/wifi>");
    p += formTokenField(); p += F("<button>");
    p += tr("Esquecer o Wi-Fi", "Forget Wi-Fi", "Olvidar el Wi-Fi");
    p += F("</button></form><form method=post action=/rec/restart>");
    p += formTokenField(); p += F("<button class=p>");
    p += tr("Reiniciar normalmente", "Restart normally", "Reiniciar normalmente");
    p += F("</button></form><form method=post action=/rec/wipe onsubmit=\"return confirm(this.dataset.q)\" data-q=\"");
    p += tr("Apagar fotos, historico, ajustes e Wi-Fi?", "Erase photos, history, settings and Wi-Fi?", "Borrar fotos, historial, ajustes y Wi-Fi?");
    p += F("\">");
    p += formTokenField(); p += F("<button>");
    p += tr("Apagar todos os dados pessoais", "Erase all personal data", "Borrar todos los datos personales");
    p += F("</button></form>");
    server.send(200, "text/html", p);
  });
  auto done = [](const __FlashStringHelper *msg) {
    server.sendHeader("Location", "/");
    server.send(303, "text/plain", msg);
  };
  server.on("/rec/factory", HTTP_POST, [done] {
    if (!formOk()) { deny(); return; }
    uint8_t lang = cfg.lang;
    defaultSettings();
    cfg.lang = lang;
    saveSettings();
    done(F("ok"));
  });
  server.on("/rec/wifi", HTTP_POST, [done] {
    if (!formOk()) { deny(); return; }
    WiFi.persistent(true);
    WiFi.disconnect(true);
    done(F("ok"));
  });
  server.on("/rec/restart", HTTP_POST, [] {
    if (!formOk()) { deny(); return; }
    server.send(200, "text/plain", "ok");
    delay(300);
    safeRestart();
  });
  // before giving away or selling the clock: the flash isn't encrypted, so this really erases
  // (files, settings with passwords, saved network) and it comes back as out of the box
  server.on("/rec/wipe", HTTP_POST, [] {
    if (!formOk()) { deny(); return; }
    server.send(200, "text/plain", "ok");
    factoryWipe();
  });
  server.on("/api/stats", HTTP_GET, sendStats);
  server.collectHeaders("X-SmallTV", "Authorization", "Content-Length", "X-Firmware-Sig");
  setupUpdate();
  server.begin();
}

// Erases files, settings (with passwords and the name) and the saved Wi-Fi, then restarts as out of the box.
// The firmware stays. Used by recovery mode and by the panel's "Prepare as a gift".
void factoryWipe() {
  delay(300);
  if (fsOk) LittleFS.format();
  for (int i = 0; i < EE_SIZE; i++) EEPROM.write(i, 0);
  if (fsLayout2()) {  // storage already formatted: without the mark the next boot would format again and offer a backup that doesn't exist
    fsMark = {FS_MAGIC, 0};
    EEPROM.put(FS_OFF, fsMark);
  }
  EEPROM.commit();
  WiFi.persistent(true);
  WiFi.disconnect(true);
  ESP.eraseConfig();
  delay(300);
  ESP.restart();
}

void rotSet(const String &v) {
  String s;
  s.reserve(min((size_t)300, v.length()) + 1);
  for (char c : v)  // only the list format: no quotes or backslashes in the state JSON
    if ((c >= 'a' && c <= 'z') || (c >= '0' && c <= '9') || c == ':' || c == ',' || c == '-' || c == '_') s += c;
  if (s.length() > 300) s = s.substring(0, s.lastIndexOf(',', 300));
  rotList = s;
  rotNext = millis() + cfg.rotMin * 60000UL;
  if (!fsOk) return;
  if (!s.length()) LittleFS.remove("/rotation.txt");
  else {
    File f = LittleFS.open("/rotation.txt", "w");
    if (f) {
      f.print(s);
      f.close();
    }
  }
}

void rotLoop() {
  if (!cfg.rotMin || !rotList.length() || phase != IDLE || previewActive() || inAlbum) return;
  if ((int32_t)(millis() - rotNext) < 0) return;
  if (cfg.mode == 2 && !album.empty() && !rotStepNow) return;  // when alternating with the album, it's scheduleView that advances
  rotNext = millis() + cfg.rotMin * 60000UL;
  fadeOutNow();  // does nothing if scheduleView already cleared it
  // the item after the current face (or the first, if the current one isn't in the list)
  String cur = cfg.theme == THEME_PACK ? String("p:") + cfg.facePkg : String("t:") + cfg.theme, l = rotList + ",";
  int at = ("," + l).indexOf("," + cur + ","), start = at >= 0 ? at + cur.length() + 1 : 0;
  for (int tries = 0; tries < 32; tries++) {  // skips invalid items (pack removed)
    if (start >= (int)l.length()) start = 0;
    int e = l.indexOf(',', start);
    String it = l.substring(start, e);
    start = e + 1;
    if (it.startsWith("t:")) {
      int t = it.substring(2).toInt();
      if (t < 0 || t >= THEME_COUNT) continue;
      cfg.theme = t;  // weatherbox: the rotation's pack stays loaded (reloading it on every pass fragments memory)
    } else if (it.startsWith("p:") && (it.substring(2) == facePackId() || loadPack(it.substring(2)))) {
      cfg.theme = THEME_PACK;
      strlcpy(cfg.facePkg, it.substring(2).c_str(), sizeof cfg.facePkg);
    } else continue;
    uiInvalidate();  // weatherbox: change by fading instead of scrolling
    return;
  }
}

// ---------- end-of-phase notices (Alexa and the like) ----------
// One address per event in /hooks.txt (end of focus, end of break). When the phase ends the clock
// calls the address (GET), and the service fires a routine: Virtual Smart Home and Voice Monkey make
// Alexa speak, IFTTT connects to hundreds of services. It goes unencrypted (http): all three accept it, and
// TLS doesn't fit on the clock. An "https://" pasted in the panel becomes "http://"; the rest of the address is checked
// by safeHttpUrl (security.h) before building the request.

void hooksLoad() {
  File f = fsOk ? LittleFS.open("/hooks.txt", "r") : File();
  if (!f) return;
  hookWork = f.readStringUntil('\n');
  hookBreak = f.readStringUntil('\n');
  f.close();
  hookWork = hookClean(hookWork);
  hookBreak = hookClean(hookBreak);
}

String hookClean(String u) {
  u.trim();
  if (u.startsWith("https://")) u = "http://" + u.substring(8);
  if (!safeHttpUrl(u.c_str(), u.length())) return "";
  return u;
}

// calls the address; returns the HTTP code (0 = no address or no Wi-Fi, negative = connection failure)
int hookFire(const String &url) {
  if (!url.length() || WiFi.status() != WL_CONNECTED) return 0;
  WiFiClient client;
  int code = httpGet(client, url, 4000);
  client.stop();
  return code;
}

// ---------- Wi-Fi: saved network or setup portal ----------
// Our own portal instead of WiFiManager (~45 KB): the binary has to fit beside the current firmware.
DNSServer dns;
bool portalMode = false;

// ---------- protection against Wi-Fi downgrade (CVE-2020-12638) ----------
// A fake beacon with the privacy bit off, together with a channel-switch announcement, makes the ESP8266
// SDK start talking WITHOUT encryption to the access point of whoever is nearby. Espressif
// didn't fix this in the Arduino core's NONOS SDK; the known workaround is to watch for a change
// in the authentication mode and reconnect when it weakens. reconnect() keeps the saved network
// (disconnect() would erase the password) and the new connection only accepts WPA or better.
WiFiEventHandler wifiAuthHandler;
volatile bool wifiDowngrade = false;

static int authRank(uint8_t m) { return m == AUTH_OPEN ? 0 : m == AUTH_WEP ? 1 : 2; }  // WPA, WPA2 and mixed: 2

// A network saved by another firmware (the original) may not require WPA: now it does, as the core's begin() does
// returns true if it had to change the saved network
bool wifiHarden() {
  struct station_config conf;
  if (!wifi_station_get_config_default(&conf) || !conf.password[0]) return false;  // open network saved: nothing to require
  bool ok = conf.threshold.authmode >= AUTH_WPA_PSK;  // NONOS 2.2: only connects to networks with this mode or better
#if (NONOSDK >= (0x30000))
  ok = ok && conf.open_and_wep_mode_disable;
  conf.open_and_wep_mode_disable = 1;
#endif
  if (ok) return false;
  conf.threshold.authmode = AUTH_WPA_PSK;
  wifi_station_set_config(&conf);
  return true;
}

void wifiGuardBegin() {
  wifiAuthHandler = WiFi.onStationModeAuthModeChanged([](const WiFiEventStationModeAuthModeChanged &e) {
    if (authRank(e.newMode) < authRank(e.oldMode)) wifiDowngrade = true;  // handled in the loop, outside the SDK
  });
}

// Connection with a fixed channel and BSSID (see connectStored): if it drops and doesn't come back soon (the router changed channel or, on a
// mesh network, the access point is another one), go back to the saved network without pinning anything.
bool wifiPinned = false;
uint32_t wifiLostAt = 0;

void wifiUnpin() {
  String ssid = WiFi.SSID(), psk = WiFi.psk();
  WiFi.persistent(false);
  WiFi.begin(ssid.c_str(), psk.c_str());
  WiFi.persistent(true);
  wifiPinned = false;
}

void wifiGuardLoop() {
  if (wifiPinned) {
    if (WiFi.status() == WL_CONNECTED) wifiLostAt = 0;
    else if (!wifiLostAt) wifiLostAt = millis() | 1;
    else if (millis() - wifiLostAt > 15000) wifiUnpin();
  }
  if (!wifiDowngrade) return;
  wifiDowngrade = false;
  wifiDowngrades++;
  WiFi.reconnect();
}

static uint32_t ssidHash(const String &s) {  // FNV-1a
  uint32_t h = 2166136261u;
  for (char c : s) h = (h ^ (uint8_t)c) * 16777619u;
  return h;
}

// Waits to connect while animating the start-up screen bar (see bootAnim)
static bool waitWifi(uint32_t ms) {
  uint32_t t0 = millis();
  while (WiFi.status() != WL_CONNECTED && millis() - t0 < ms) {
    bootAnim(0);
    delay(30);
  }
  return WiFi.status() == WL_CONNECTED;
}

// Network saved in the SDK. With the last router's channel and BSSID (EEPROM, see wifiHintSave) the SDK doesn't scan the 13
// channels: it connects directly. RAM only (persistent off): the pinned BSSID doesn't go to flash, which keeps the usual
// network. If it doesn't connect within a few seconds, it falls back to the full scan.
bool connectStored(uint32_t timeoutMs) {
  uint32_t t0 = millis();
  WiFi.mode(WIFI_STA);
  WiFi.hostname(netName);
  bool hardened = wifiHarden();
  if (!hardened && WiFi.status() == WL_CONNECTED) {  // the SDK connected by itself while the screen was starting
    bootWifiPath = 2;
    return true;
  }
  WifiHint h;
  EEPROM.get(WIFIH_OFF, h);
  String ssid = WiFi.SSID(), psk = WiFi.psk();
  if (!ssid.length() || h.magic != WIFI_MAGIC || h.ssid != ssidHash(ssid) || h.chan < 1 || h.chan > 13) {
    WiFi.begin();
    return waitWifi(timeoutMs);
  }
  WiFi.persistent(false);
  WiFi.begin(ssid.c_str(), psk.c_str(), h.chan, h.bssid);
  bool ok = waitWifi(min<uint32_t>(4000, timeoutMs));
  if (ok) {
    bootWifiPath = 1;
    wifiPinned = true;
  } else {
    bootWifiPath = 3;
    WiFi.begin(ssid.c_str(), psk.c_str());
    uint32_t used = millis() - t0;
    ok = waitWifi(used < timeoutMs ? timeoutMs - used : 0);
  }
  WiFi.persistent(true);
  return ok;
}

// Stores the current router's channel and BSSID; only writes flash if it changed (another network, channel or router)
void wifiHintSave() {
  String ssid = WiFi.SSID();
  int32_t ch = WiFi.channel();
  if (!ssid.length() || ch < 1 || ch > 13) return;
  WifiHint h = {WIFI_MAGIC, ssidHash(ssid), {}, (uint8_t)ch, 0}, old;
  memcpy(h.bssid, WiFi.BSSID(), 6);
  EEPROM.get(WIFIH_OFF, old);
  if (!memcmp(&old, &h, sizeof h)) return;
  EEPROM.put(WIFIH_OFF, h);
  EEPROM.commit();
}

void htmlEscapeAppend(String &o, const String &s) {
  for (char c : s) {
    if (c == '<') o += "&lt;";
    else if (c == '>') o += "&gt;";
    else if (c == '&') o += "&amp;";
    else if (c == '"') o += "&quot;";
    else o += c;
  }
}

void startPortal() {
  newFormToken();
  portalMode = true;
  WiFi.mode(WIFI_AP_STA);
  WiFi.softAP(AP_NAME, cfg.apPass);
  dns.start(53, "*", WiFi.softAPIP());
  String pw = String(tr("senha: ", "password: ", "clave: ")) + cfg.apPass;
  uiSetupWifi(AP_NAME, cfg.apPass);  // weatherbox: steps and a QR code to join the network from a phone
  server.on("/", HTTP_GET, [] {
    int n = WiFi.scanNetworks();
    String opts;
    opts.reserve(min(2048, max(0, n) * 48));
    for (int i = 0; i < n; i++) {
      opts += F("<option>");
      htmlEscapeAppend(opts, WiFi.SSID(i));
      opts += F("</option>");
    }
    String p;
    p.reserve(900 + opts.length());
    p = F("<!doctype html><meta charset=utf-8><meta name=viewport content='width=device-width,initial-scale=1'>"
          "<title>Weather Clock Wi-Fi</title><style>body{font:16px system-ui;background:#111;color:#eee;max-width:380px;margin:auto;padding:20px}"
          "input,button{width:100%;padding:12px;margin:6px 0 14px;border-radius:10px;border:1px solid #333;background:#1c1c1c;color:#eee;font:inherit}"
          "button{background:#ff5a47;border:0;font-weight:700}</style><h2>Weather Clock Wi-Fi</h2><form method=post action=/save>");
    p += tr("Rede", "Network", "Red");
    p += F("<input name=s list=l required><datalist id=l>");
    p += opts;
    p += F("</datalist>");
    p += formTokenField();
    p += tr("Senha", "Password", "Contrase&ntilde;a");
    p += F("<input name=p type=password><button>");
    p += tr("Conectar", "Connect", "Conectar");
    p += F("</button></form><p style='color:#aaa;font-size:14px'>");
    p += tr("Use uma rede de 2,4 GHz: o relogio nao enxerga redes de 5 GHz. Se o roteador junta as duas com o mesmo nome, costuma funcionar.",
            "Use a 2.4 GHz network: the clock can't see 5 GHz ones. If your router uses one name for both, that usually works.",
            "Usa una red de 2,4 GHz: el reloj no ve redes de 5 GHz. Si el router usa un solo nombre para ambas, suele funcionar.");
    p += F("</p>");
    server.send(200, "text/html", p);
  });
  server.on("/save", HTTP_POST, [] {
    if (!formOk()) { deny(); return; }
    String p = F("<meta charset=utf-8><body style='font:16px system-ui;background:#111;color:#eee;padding:20px'>");
    PGM_P done[3] = {PSTR("Conectando... O rel&oacute;gio vai reiniciar e mostrar o endere&ccedil;o do painel na tela."),
                     PSTR("Connecting... The clock will restart and show the panel address on screen."),
                     PSTR("Conectando... El reloj se reiniciar&aacute; y mostrar&aacute; la direcci&oacute;n del panel en la pantalla.")};
    p += FPSTR(done[cfg.lang]);  // too long for the tr() buffer
    server.send(200, "text/html", p);
    delay(500);
    WiFi.persistent(true);
    WiFi.begin(server.arg("s").c_str(), server.arg("p").c_str());
    delay(1000);
    safeRestart();
  });
  // any other address lands on the form (the phone's captive portal)
  server.onNotFound([] {
    server.sendHeader("Location", "http://192.168.4.1/");
    server.send(302, "text/plain", "");
  });
  server.begin();
}

// ---------- setup / loop ----------
// After connecting, the start-up screen stays a few seconds with the panel's address; the loop runs as normal (panel,
// SNTP, weather) instead of stalling in a delay. It leaves early if someone uses the clock.
uint32_t bootHoldUntil = 0;
bool bootTitleTime = false;  // the title already says "Connected" (the time arrived)
void bootConnectedScreen() {
  String addr = String(lanName[0] ? lanName : netName) + ".local";
  bootTitleTime = timeValid();
  message(bootTitleTime ? tr("Conectado", "Connected", "Conectado") : tr("Acertando a hora", "Setting the time", "Ajustando la hora"),
          addr.c_str(), WiFi.localIP().toString().c_str());
}

void setup() {
  snprintf(netName, sizeof netName, HOSTNAME "-%04x", (unsigned)(ESP.getChipId() & 0xFFFF));
  pinMode(PIN_BL, OUTPUT);
  analogWriteRange(BL_RANGE);
  analogWriteFreq(BL_HZ);
  loadSettings();
  BootCount bc;
  EEPROM.get(BOOT_OFF, bc);
  uint8_t boots = bc.magic == BOOT_MAGIC ? bc.n : 0;
  crashLoad();
  rtcTimeRestore();  // software restart: the previous time is already valid (unconfirmed) while Wi-Fi connects
  recoveryMode = boots + 1 >= 3;
  setBootCount(recoveryMode ? 0 : boots + 1);  // recovery applies once; the next restart is normal
  updateBrightness(true);

  tft.init(240, 240, SPI_MODE3);
  tft.setSPISpeed(40000000);  // 80 MHz is beyond the ST7789's limit: the picture turns to garbage
  applyVcom(cfg.vcom);
  uiBegin(&tft);
  uiSetLang(cfg.lang);
  uiSetOwner(cfg.devName);
  // between animation frames (the Flip turnover): gives time to Wi-Fi and paces the turnover
  uiFrameHook = [] { yield(); };  // the animation is driven by the clock: it only gives time to Wi-Fi
  uiMillis = [] { return (uint32_t)millis(); };
  // pixel rows through the ST7789's fast path (drawRGBBitmap isn't virtual in Adafruit_GFX)
  uiBlit = tftBitmap;
  uiScrollHw = tftScroll;
  applyPanel();
  // The start-up screen appears straight away: mounting file storage, the history, the face and the photo list takes
  // a few seconds, and with a black screen it looked frozen.
  message("Weather Clock", tr("Iniciando", "Starting", "Iniciando"), "v" FW_VERSION);
  bootScreenMs = millis() | 1;
  uiBootProgress(millis(), 0);

  fsMount();
  statsLoad();
  if (fsOk) {
    File rf = LittleFS.open("/rotation.txt", "r");
    if (rf) {
      rotList = rf.readString();
      rf.close();
    }
  }
  hooksLoad();
  if (recoveryMode) {  // no packs, album or weather: only what's needed to fix things
    startRecovery();
    return;
  }
  uiDrawImage = drawJpgAt;
  if (cfg.theme == THEME_PACK) restoreActivePack();  // missing/invalid pack: back to Matrix
  rebuildAlbum();

  uiMessageLine(tr("Conectando Wi-Fi", "Connecting Wi-Fi", "Conectando Wi-Fi"));

  // Uses the network saved in the ESP8266 (including one the original firmware had already set up).
  wifiGuardBegin();
  timeGuardBegin();
  if (!connectStored(20000)) {
    startPortal();
    return;
  }
  bootWifiMs = millis() | 1;
  wifiHintSave();
  applyTimezone();  // SNTP already asks for the time while the rest starts up
  ntpAskAt = millis();
  setupWeb();
  alexaBegin();
  mdnsStart();
  bootConnectedScreen();
  bootHoldUntil = (millis() + 3000) | 1;  // the address stays on screen for 3 s, but the rest is already running (see loop)
}

uint32_t lastRender = 0, lastBriCheck = 0;

void loop() {
  diagLoop();
  if (bootCount && millis() > 30000) setBootCount(0);  // it stayed on: it wasn't a short boot
  if (memRestartAt && millis() - memRestartAt > 2000) safeRestart();  // gives time to answer whoever asked
  // weatherbox: daily restart at 4 am (local time) so memory starts clean; only after 2 h of uptime,
  // so it doesn't repeat in the same minute, and never in the middle of a firmware update
  static uint32_t nightlyCheck = 0;
  if (millis() - nightlyCheck > 20000) {
    nightlyCheck = millis();
    if (millis() > 7200000UL && timeValid() && !Update.isRunning()) {
      time_t now = time(nullptr);
      struct tm t;
      localtime_r(&now, &t);
      if (t.tm_hour == 4 && t.tm_min < 5) safeRestart();
    }
  }
  if (recoveryMode) {
    server.handleClient();
    return;
  }
  if (portalMode) {
    dns.processNextRequest();
    server.handleClient();
    // no setup within 5 min (e.g. the router was off): restart and try the saved network again
    if (millis() > 300000) safeRestart();
    return;
  }
  server.handleClient();
  mdnsLoop();
  statsFlush();
  wifiGuardLoop();
  alexaLoop();
  tickPomodoro();
  weatherLoop();
  rotLoop();
  if (hookPending >= 0) {  // the phase ended: send the notice (outside the Pomodoro tick; takes up to 4 s without good Wi-Fi)
    int8_t p = hookPending;
    hookPending = -1;
    hookFire(p ? hookBreak : hookWork);
  }

  uint32_t now = millis();
  if (now - lastBriCheck > 5000) {
    lastBriCheck = now;
    updateBrightness();
    timeGuard.tick(time(nullptr), now);
    rtcTimeSave();
  }
  briFade();
  // SNTP didn't answer: ask again (with another server first) instead of waiting for lwIP, which takes ~15 s
  if (ntpAskAt && !bootNtpMs && ntpTries < 4 && now - ntpAskAt > 6000 && WiFi.status() == WL_CONNECTED) {
    ntpAskAt = now;
    applyTimezone(++ntpTries);
  }

  if (bootHoldUntil) {
    if ((int32_t)(now - bootHoldUntil) < 0 && phase == IDLE && !previewActive() && !vcomTestUntil && !colorTestRequested) {
      if (timeValid() && !bootTitleTime) bootConnectedScreen();
      bootAnim(timeValid() ? 2 : 1);
      return;
    }
    bootHoldUntil = 0;
    uiInvalidate();
    viewUntil = 0;
  }

  if (vcomTestUntil) {
    if ((int32_t)(now - vcomTestUntil) < 0) {
      if (vcomDraw) {
        if (inAlbum) stopAlbum();
        uiVcomTest(vcomTest, vcomDraw == 2);
        vcomDraw = 0;
      }
      return;
    }
    vcomTestUntil = 0;  // end of the test: back to the saved value and the face
    applyVcom(cfg.vcom);
    uiInvalidate();
    viewUntil = 0;
  }

  if (colorTestRequested) {
    colorTestRequested = false;
    if (inAlbum) stopAlbum();
    uiColorTest();
    colorTestUntil = now + 10000;
  }
  if (colorTestUntil) {
    if ((int32_t)(now - colorTestUntil) < 0) return;
    colorTestUntil = 0;
    uiInvalidate();
    viewUntil = 0;
  }

  if (previewUntil && !previewActive()) {  // end of the preview: back to the saved face
    previewUntil = 0;
    viewUntil = 0;
    if (previewTheme == THEME_PACK) restoreActivePack();
  }
  if (previewActive()) {
    if (inAlbum) stopAlbum();
  } else if (phase == IDLE) {
    scheduleView();
    albumLoop();  // GIF frames need to run outside the 100 ms limit
  } else if (inAlbum) {
    stopAlbum();
    viewUntil = 0;
  }

  if (now - lastRender < 100) return;
  lastRender = now;

  if (alertUntil) {
    if ((int32_t)(now - alertUntil) < 0) renderAlert();
    else { alertUntil = 0; tft.invertDisplay(cfg.invert); }  // back to the panel tweak
  }
  if (phase != IDLE) renderPomodoro();
  else {
    pomoShown = false;  // on the next entry the Pomodoro screen is drawn in full again
    if (!inAlbum) renderClock();
  }
  if (fadeInPending) fadeInStart();  // the new screen (face or the album's 1st frame) is already drawn
}
